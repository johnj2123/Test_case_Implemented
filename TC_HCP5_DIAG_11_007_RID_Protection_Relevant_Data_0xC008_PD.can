includes
{
  #include "../diaglibrary.cin"
  #include "../DiagLibraryAI.cin"
}

/*=============================================================================
  Test Case : TC_HCP5_DIAG_11_007_RID_Protection_Relevant_Data_0xC008_PD
  Source     : HCP5_SysTest
  Domain     : PD
  Purpose    : Verifies RID 0xC008 (Protection Relevant Data / E2E Challenge
               Token) behaviour on PD domain:
               - Rejected (NRC 0x31) in Default and Programming sessions
               - Returns positive challenge token in Extended session for
                 all Tipo (protection object type) variants: 01..07

  NOTE - Deviations from spec (see diff_between_spec_report.xlsx rows 31-34):
    1. Session for NRC checks: Spec says Default -> Programming for step 3.
       Report skips Programming; uses Extended -> SetExtendedSevice instead.
       Script follows spec intent: Extended -> Programming (via library) for
       NRC step 3, then recovers Default -> Extended before positive tests.
    2. NRC evaluation: Report uses RoutineReqC008(Response=0) without showing
       an explicit 0x31 byte check. Script explicitly asserts NRC == 0x31.
    3. Response payload: Spec mentions [FAS]/[RES]/[SYS]/[IAS]/[ARS] protection
       object type tokens. Report does not evaluate token content (nonce bytes).
       Script checks positive response header bytes only (71 01 C0 08) — token
       content (byte[4] onwards) is a nonce and is not verified.
    4. Session reset: Report does Default -> Extended between NRC group and
       positive group. Script follows this pattern.


  Tipo byte (C008 request byte[4]) mapping:
    0x01 = FAS  (Frontend Access Service)
    0x02 = FAS  (Frontend Access Service - challenge request)
    0x03 = RES  (Reserved)
    0x04 = SYS  (System)
    0x05 = IAS  (Internal Access Service)
    0x06 = FAS  (variant)
    0x07 = ARS  (also used by GetEEChallengeToken for E2E unlock flow)

  Preconditions:
    1. Clamp 30 enabled
    2. Clamp 15 enabled
    3. Restbus simulation running
    4. Connect Diag Client to Diag-CAN
    5. Default Diagnostic Session (0x01)

  Post-Conditions: none
=============================================================================*/
testcase TC_HCP5_DIAG_11_007_RID_Protection_Relevant_Data_0xC008_PD()
{
  /* Wildcard typed objects for raw byte access */
  diagRequest  HCP5_Diag_PD.* req;
  diagResponse HCP5_Diag_PD.* resp;

  byte    rawReq[8];
  byte    readBuf[4095];
  long    len;
  long    nrc;
  long    receivedNRC;

  write("=== TC_HCP5_DIAG_11_007_RID_Protection_Relevant_Data_0xC008_PD START ===");

  /*==========================================================
    PRECONDITIONS
  ==========================================================*/
  EnableClamp30();
  testStepPass("Precondition", "Clamp 30 enabled");

  EnableClamp15();
  testStepPass("Precondition", "Clamp 15 enabled");

  StartRestBusSimulation();
  testStepPass("Precondition", "Restbus simulation running");

  testWaitForTimeout(20000);  /* ECU boot after Klemme15 */

  ConnectDiagClientToDiagCAN();
  testStepPass("Precondition", "Diag client connected to Diag-CAN");

  testWaitForTimeout(500);

  /* Ensure we start in Default session */
  SetDefaultDiagnosticSession_PD(3000);
  testStepPass("Precondition", "Default Session (0x01) established");

  testWaitForTimeout(500);

  /*======================================================
    STEP 1
    Send 31 01 C0 08 02 in Default Session
    Expected: NRC 0x31 (requestOutOfRange)
  ======================================================*/
  testStep("Step 1", "Send C008 Tipo=0x02 in Default Session - expect NRC 0x31");

  rawReq[0] = 0x31; rawReq[1] = 0x01; rawReq[2] = 0xC0; rawReq[3] = 0x08; rawReq[4] = 0x02;
  diagResize(req, 5);
  diagSetPrimitiveData(req, rawReq, 5);
  diagSendRequest(req);
  testWaitForDiagResponse(req, 5000);
  nrc = diagGetLastResponseCode(req);

  if (nrc >= 0)
  {
    receivedNRC = nrc;
    if (receivedNRC == 0x31)
      testStepPass("Result 1", "NRC 0x31 (requestOutOfRange) received as expected in Default session");
    else
      testStepFail("Result 1", "Wrong NRC=0x%02X (expected 0x31) in Default session", receivedNRC);
  }
  else
  {
    diagGetLastResponse(req, resp);
    len = diagGetPrimitiveData(resp, readBuf, elcount(readBuf));
    if (len > 0)
      testStepFail("Result 1", "Unexpected positive response in Default session (len=%d)", len);
    else
      testStepFail("Result 1", "No response / error, rc=%d", len);
  }

  testWaitForTimeout(500);

  /*======================================================
    STEP 2
    Enter Programming Session (via Extended first)
    Report deviation: report uses Extended+SetExtendedSevice;
    script follows spec and enters Programming.
  ======================================================*/
  testStep("Step 2", "Enter Programming Session (10 02) via Extended");

  /* Must go Extended first, then Programming */
  if (SetExtendedDiagnosticSession_PD(3000) != 0)
  {
    testStepFail("Result 2", "Failed to enter Extended Session (intermediate for Programming)");
    return;
  }
  if (SetProgrammingDiagnosticSession_PD(3000) != 0)
  {
    testStepFail("Result 2", "Failed to enter Programming Session");
    return;
  }
  testStepPass("Result 2", "Programming Session (0x02) entered");

  testWaitForTimeout(500);

  /*======================================================
    STEP 3
    Send 31 01 C0 08 02 in Programming Session
    Expected: NRC 0x31 (requestOutOfRange)
  ======================================================*/
  testStep("Step 3", "Send C008 Tipo=0x02 in Programming Session - expect NRC 0x31");

  rawReq[0] = 0x31; rawReq[1] = 0x01; rawReq[2] = 0xC0; rawReq[3] = 0x08; rawReq[4] = 0x02;
  diagResize(req, 5);
  diagSetPrimitiveData(req, rawReq, 5);
  diagSendRequest(req);
  testWaitForDiagResponse(req, 5000);
  nrc = diagGetLastResponseCode(req);

  if (nrc >= 0)
  {
    receivedNRC = nrc;
    if (receivedNRC == 0x31)
      testStepPass("Result 3", "NRC 0x31 (requestOutOfRange) received as expected in Programming session");
    else
      testStepFail("Result 3", "Wrong NRC=0x%02X (expected 0x31) in Programming session", receivedNRC);
  }
  else
  {
    diagGetLastResponse(req, resp);
    len = diagGetPrimitiveData(resp, readBuf, elcount(readBuf));
    if (len > 0)
      testStepFail("Result 3", "Unexpected positive response in Programming session (len=%d)", len);
    else
      testStepFail("Result 3", "No response / error, rc=%d", len);
  }

  testWaitForTimeout(500);

  /*======================================================
    SESSION RECOVERY
    Default -> Extended (as per report pattern before positive tests)
  ======================================================*/
  SetDefaultDiagnosticSession_PD(3000);
  testWaitForTimeout(300);
  if (SetExtendedDiagnosticSession_PD(3000) != 0)
  {
    testStepFail("Session recovery", "Failed to enter Extended Session for positive tests");
    return;
  }
  testStepPass("Session recovery", "Recovered to Extended Session (0x03) for positive C008 tests");

  testWaitForTimeout(500);

  /*======================================================
    STEP 4 (spec step 5)
    Send 31 01 C0 08 02 in Extended Session - Tipo=0x02 [FAS]
    Expected: Positive response 71 01 C0 08 ...
  ======================================================*/
  testStep("Step 4", "Send C008 Tipo=0x02 [FAS] in Extended Session - expect positive");

  rawReq[0] = 0x31; rawReq[1] = 0x01; rawReq[2] = 0xC0; rawReq[3] = 0x08; rawReq[4] = 0x02;
  diagResize(req, 5);
  diagSetPrimitiveData(req, rawReq, 5);
  diagSendRequest(req);
  testWaitForDiagResponse(req, 5000);
  nrc = diagGetLastResponseCode(req);
  if (nrc >= 0) { len = -(0x100 + nrc); }
  else { diagGetLastResponse(req, resp); len = diagGetPrimitiveData(resp, readBuf, elcount(readBuf)); }

  if (len > 0)
  {
    if (readBuf[0] == 0x71 && readBuf[2] == 0xC0 && readBuf[3] == 0x08)
      testStepPass("Result 4", "C008 Tipo=0x02 [FAS]: positive response 71 01 C0 08, len=%d", len);
    else
      testStepFail("Result 4", "Unexpected header: %02X %02X %02X %02X", readBuf[0], readBuf[1], readBuf[2], readBuf[3]);
  }
  else if (len <= -256)
    testStepFail("Result 4", "NRC=0x%02X (expected positive)", (-len)-256);
  else
    testStepFail("Result 4", "C008 Tipo=0x02 failed, rc=%d", len);

  testWaitForTimeout(300);

  /*======================================================
    STEP 5 (spec step 6)
    Send 31 01 C0 08 01 in Extended Session - Tipo=0x01 [FAS]
    Expected: Positive response 71 01 C0 08 ...
  ======================================================*/
  testStep("Step 5", "Send C008 Tipo=0x01 [FAS] in Extended Session - expect positive");

  rawReq[0] = 0x31; rawReq[1] = 0x01; rawReq[2] = 0xC0; rawReq[3] = 0x08; rawReq[4] = 0x01;
  diagResize(req, 5);
  diagSetPrimitiveData(req, rawReq, 5);
  diagSendRequest(req);
  testWaitForDiagResponse(req, 5000);
  nrc = diagGetLastResponseCode(req);
  if (nrc >= 0) { len = -(0x100 + nrc); }
  else { diagGetLastResponse(req, resp); len = diagGetPrimitiveData(resp, readBuf, elcount(readBuf)); }

  if (len > 0)
  {
    if (readBuf[0] == 0x71 && readBuf[2] == 0xC0 && readBuf[3] == 0x08)
      testStepPass("Result 5", "C008 Tipo=0x01 [FAS]: positive response 71 01 C0 08, len=%d", len);
    else
      testStepFail("Result 5", "Unexpected header: %02X %02X %02X %02X", readBuf[0], readBuf[1], readBuf[2], readBuf[3]);
  }
  else if (len <= -256)
    testStepFail("Result 5", "NRC=0x%02X (expected positive)", (-len)-256);
  else
    testStepFail("Result 5", "C008 Tipo=0x01 failed, rc=%d", len);

  testWaitForTimeout(300);

  /*======================================================
    STEP 6 (spec step 7)
    Send 31 01 C0 08 03 in Extended Session - Tipo=0x03 [RES]
    Expected: Positive response 71 01 C0 08 ...
  ======================================================*/
  testStep("Step 6", "Send C008 Tipo=0x03 [RES] in Extended Session - expect positive");

  rawReq[0] = 0x31; rawReq[1] = 0x01; rawReq[2] = 0xC0; rawReq[3] = 0x08; rawReq[4] = 0x03;
  diagResize(req, 5);
  diagSetPrimitiveData(req, rawReq, 5);
  diagSendRequest(req);
  testWaitForDiagResponse(req, 5000);
  nrc = diagGetLastResponseCode(req);
  if (nrc >= 0) { len = -(0x100 + nrc); }
  else { diagGetLastResponse(req, resp); len = diagGetPrimitiveData(resp, readBuf, elcount(readBuf)); }

  if (len > 0)
  {
    if (readBuf[0] == 0x71 && readBuf[2] == 0xC0 && readBuf[3] == 0x08)
      testStepPass("Result 6", "C008 Tipo=0x03 [RES]: positive response 71 01 C0 08, len=%d", len);
    else
      testStepFail("Result 6", "Unexpected header: %02X %02X %02X %02X", readBuf[0], readBuf[1], readBuf[2], readBuf[3]);
  }
  else if (len <= -256)
    testStepFail("Result 6", "NRC=0x%02X (expected positive)", (-len)-256);
  else
    testStepFail("Result 6", "C008 Tipo=0x03 failed, rc=%d", len);

  testWaitForTimeout(300);

  /*======================================================
    STEP 7 (spec step 8)
    Send 31 01 C0 08 04 in Extended Session - Tipo=0x04 [SYS]
    Expected: Positive response 71 01 C0 08 ...
  ======================================================*/
  testStep("Step 7", "Send C008 Tipo=0x04 [SYS] in Extended Session - expect positive");

  rawReq[0] = 0x31; rawReq[1] = 0x01; rawReq[2] = 0xC0; rawReq[3] = 0x08; rawReq[4] = 0x04;
  diagResize(req, 5);
  diagSetPrimitiveData(req, rawReq, 5);
  diagSendRequest(req);
  testWaitForDiagResponse(req, 5000);
  nrc = diagGetLastResponseCode(req);
  if (nrc >= 0) { len = -(0x100 + nrc); }
  else { diagGetLastResponse(req, resp); len = diagGetPrimitiveData(resp, readBuf, elcount(readBuf)); }

  if (len > 0)
  {
    if (readBuf[0] == 0x71 && readBuf[2] == 0xC0 && readBuf[3] == 0x08)
      testStepPass("Result 7", "C008 Tipo=0x04 [SYS]: positive response 71 01 C0 08, len=%d", len);
    else
      testStepFail("Result 7", "Unexpected header: %02X %02X %02X %02X", readBuf[0], readBuf[1], readBuf[2], readBuf[3]);
  }
  else if (len <= -256)
    testStepFail("Result 7", "NRC=0x%02X (expected positive)", (-len)-256);
  else
    testStepFail("Result 7", "C008 Tipo=0x04 failed, rc=%d", len);

  testWaitForTimeout(300);

  /*======================================================
    STEP 8 (spec step 9)
    Send 31 01 C0 08 05 in Extended Session - Tipo=0x05 [IAS]
    Expected: Positive response 71 01 C0 08 ...
  ======================================================*/
  testStep("Step 8", "Send C008 Tipo=0x05 [IAS] in Extended Session - expect positive");

  rawReq[0] = 0x31; rawReq[1] = 0x01; rawReq[2] = 0xC0; rawReq[3] = 0x08; rawReq[4] = 0x05;
  diagResize(req, 5);
  diagSetPrimitiveData(req, rawReq, 5);
  diagSendRequest(req);
  testWaitForDiagResponse(req, 5000);
  nrc = diagGetLastResponseCode(req);
  if (nrc >= 0) { len = -(0x100 + nrc); }
  else { diagGetLastResponse(req, resp); len = diagGetPrimitiveData(resp, readBuf, elcount(readBuf)); }

  if (len > 0)
  {
    if (readBuf[0] == 0x71 && readBuf[2] == 0xC0 && readBuf[3] == 0x08)
      testStepPass("Result 8", "C008 Tipo=0x05 [IAS]: positive response 71 01 C0 08, len=%d", len);
    else
      testStepFail("Result 8", "Unexpected header: %02X %02X %02X %02X", readBuf[0], readBuf[1], readBuf[2], readBuf[3]);
  }
  else if (len <= -256)
    testStepFail("Result 8", "NRC=0x%02X (expected positive)", (-len)-256);
  else
    testStepFail("Result 8", "C008 Tipo=0x05 failed, rc=%d", len);

  testWaitForTimeout(300);

  /*======================================================
    STEP 9 (spec step 10)
    Send 31 01 C0 08 06 in Extended Session - Tipo=0x06 [FAS]
    Expected: Positive response 71 01 C0 08 ...
  ======================================================*/
  testStep("Step 9", "Send C008 Tipo=0x06 [FAS] in Extended Session - expect positive");

  rawReq[0] = 0x31; rawReq[1] = 0x01; rawReq[2] = 0xC0; rawReq[3] = 0x08; rawReq[4] = 0x06;
  diagResize(req, 5);
  diagSetPrimitiveData(req, rawReq, 5);
  diagSendRequest(req);
  testWaitForDiagResponse(req, 5000);
  nrc = diagGetLastResponseCode(req);
  if (nrc >= 0) { len = -(0x100 + nrc); }
  else { diagGetLastResponse(req, resp); len = diagGetPrimitiveData(resp, readBuf, elcount(readBuf)); }

  if (len > 0)
  {
    if (readBuf[0] == 0x71 && readBuf[2] == 0xC0 && readBuf[3] == 0x08)
      testStepPass("Result 9", "C008 Tipo=0x06 [FAS]: positive response 71 01 C0 08, len=%d", len);
    else
      testStepFail("Result 9", "Unexpected header: %02X %02X %02X %02X", readBuf[0], readBuf[1], readBuf[2], readBuf[3]);
  }
  else if (len <= -256)
    testStepFail("Result 9", "NRC=0x%02X (expected positive)", (-len)-256);
  else
    testStepFail("Result 9", "C008 Tipo=0x06 failed, rc=%d", len);

  testWaitForTimeout(300);

  /*======================================================
    STEP 10 (spec step 11)
    Send 31 01 C0 08 07 in Extended Session - Tipo=0x07 [ARS]
    This is also the Tipo used by GetEEChallengeToken() in the
    E2E unlock flow (diaglibrary.cin:3729).
    Expected: Positive response 71 01 C0 08 ...
  ======================================================*/
  testStep("Step 10", "Send C008 Tipo=0x07 [ARS / E2E challenge] in Extended Session - expect positive");

  rawReq[0] = 0x31; rawReq[1] = 0x01; rawReq[2] = 0xC0; rawReq[3] = 0x08; rawReq[4] = 0x07;
  diagResize(req, 5);
  diagSetPrimitiveData(req, rawReq, 5);
  diagSendRequest(req);
  testWaitForDiagResponse(req, 5000);
  nrc = diagGetLastResponseCode(req);
  if (nrc >= 0) { len = -(0x100 + nrc); }
  else { diagGetLastResponse(req, resp); len = diagGetPrimitiveData(resp, readBuf, elcount(readBuf)); }

  if (len > 0)
  {
    if (readBuf[0] == 0x71 && readBuf[2] == 0xC0 && readBuf[3] == 0x08)
      testStepPass("Result 10", "C008 Tipo=0x07 [ARS]: positive response 71 01 C0 08, len=%d", len);
    else
      testStepFail("Result 10", "Unexpected header: %02X %02X %02X %02X", readBuf[0], readBuf[1], readBuf[2], readBuf[3]);
  }
  else if (len <= -256)
    testStepFail("Result 10", "NRC=0x%02X (expected positive)", (-len)-256);
  else
    testStepFail("Result 10", "C008 Tipo=0x07 failed, rc=%d", len);

  /*==========================================================
    POST-CONDITIONS
  ==========================================================*/
  testWaitForTimeout(1000);
  testStepPass("Postcondition", "none");
  write("=== TC_HCP5_DIAG_11_007_RID_Protection_Relevant_Data_0xC008_PD END ===");
}

void MainTest()
{
  TC_HCP5_DIAG_11_007_RID_Protection_Relevant_Data_0xC008_PD();
}
