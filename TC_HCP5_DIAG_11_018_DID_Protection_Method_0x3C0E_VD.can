includes
{
  #include "../diaglibrary.cin"
  #include "../DiagLibraryAI.cin"
}

/*=============================================================================
  Test Case : TC_HCP5_DIAG_11_018_DID_Protection_Method_$3C0E_VD
  Domain     : VD (HCP5_Diagnostics_VD)
  Purpose    : Verifies DID 0x3C0E (Protection Method) read access per session:
               - Default Session   -> positive response, Data = 0x03
               - Extended Session  -> positive response, Data = 0x03
               - Programming Session -> negative response (DID not available)

  NOTE - Deviations from spec (see diff_between_spec_report.xlsx rows 44-45):
    1. Spec step 4: "Enter ECU Programming Session 0x02."
       Report does: Extended -> SetExtendedSevice (sub-function unlock, ~1775ms)
       -> Programming. SetProgrammingDiagnosticSession_VD() encapsulates this
       internally using the SetExtendedSevice typed object. Report also calls
       ClearDTC before Programming entry; script uses UdsClearDTC_VD() for this.
    2. Spec step 5: NRC code not specified ("not available in this session").
       Report only checks that a Negative Response is received — no specific
       NRC byte verified. Script accepts any NRC and logs the value.

  Preconditions:
    1. Clamp 30 enabled
    2. Clamp 15 enabled
    3. Restbus simulation running
    4. Connect Diag Client to Diag-CAN
    5. ECU SFD locked (VD)
    6. Default Diagnostic Session 0x01

  Steps:
    1. Read DID 0x3C0E in Default Session   -> expect 62 3C 0E 03
    2. Enter Extended Session 0x03
    3. Read DID 0x3C0E in Extended Session  -> expect 62 3C 0E 03
    4. Enter Programming Session 0x02 (via Extended -> Programming)
    5. Read DID 0x3C0E in Programming       -> expect Negative Response

  Post-Conditions: none
=============================================================================*/
testcase TC_HCP5_DIAG_11_018_DID_Protection_Method_0x3C0E_VD()
{
  diagRequest  HCP5_Diag_VD.* req;
  diagResponse HCP5_Diag_VD.* resp;

  byte    rawReq[8];
  byte    readBuf[4095];
  byte    dtcGroup[3];
  long    len;
  long    rc;
  long    receivedNRC;

  write("=== TC_HCP5_DIAG_11_018_DID_Protection_Method_0x3C0E_VD START ===");

  /*==========================================================
    PRECONDITIONS
  ==========================================================*/
  EnableClamp30();
  testStepPass("Precondition", "Clamp 30 enabled");

  EnableClamp15();
  testStepPass("Precondition", "Clamp 15 enabled");

  StartRestBusSimulation();
  testStepPass("Precondition", "Restbus simulation running");

  testWaitForTimeout(20000);  /* ECU boot */

  ConnectDiagClientToDiagCAN();
  testStepPass("Precondition", "Diag client connected to Diag-CAN");

  testWaitForTimeout(500);

  /* Lock SFD on VD */
  rc = SetExtendedDiagnosticSession_VD(3000);
  if (rc != 0) { testStepFail("Precondition", "Failed to enter Extended Session (VD) for SFD lock"); return; }

  rc = SFD_lock();
  if (rc != 0)
    testStepFail("Precondition", "SFD_lock() failed, rc=%d", rc);
  else
    testStepPass("Precondition", "SFD locked via SFD_lock()");

  testWaitForTimeout(500);

  rc = SetDefaultDiagnosticSession_VD(3000);
  if (rc != 0) { testStepFail("Precondition", "Failed to return to Default Session"); return; }

  testWaitForTimeout(500);

  /*======================================================
    STEP 1
    Read DID 0x3C0E in Default Session
    Expected: 62 3C 0E 03 (Data = 0x03)
    Report: Data Bytes [1] 03 pass
  ======================================================*/
  testStep("Step 1", "Read DID 0x3C0E in Default Session - expect 62 3C 0E 03");

  rawReq[0] = 0x22; rawReq[1] = 0x3C; rawReq[2] = 0x0E;
  diagResize(req, 3);
  diagSetPrimitiveData(req, rawReq, 3);
  diagSendRequest(req);
  testWaitForDiagResponse(req, 5000);
  rc = diagGetLastResponseCode(req);

  if (rc >= 0)
  {
    testStepFail("Result 1", "NRC=0x%02X received (expected positive 62 3C 0E 03)", rc);
  }
  else
  {
    diagGetLastResponse(req, resp);
    len = diagGetPrimitiveData(resp, readBuf, elcount(readBuf));
    if (len >= 4 && readBuf[0]==0x62 && readBuf[1]==0x3C && readBuf[2]==0x0E && readBuf[3]==0x03)
      testStepPass("Result 1", "DID 0x3C0E = 62 3C 0E 03 (Data=0x03) in Default Session");
    else if (len >= 4)
      testStepFail("Result 1", "DID 0x3C0E = %02X %02X %02X %02X (expected 62 3C 0E 03)",
                   readBuf[0], readBuf[1], readBuf[2], readBuf[3]);
    else
      testStepFail("Result 1", "DID 0x3C0E read failed, len=%d", len);
  }

  testWaitForTimeout(300);

  /*======================================================
    STEP 2
    Enter Extended Diagnostic Session 0x03
  ======================================================*/
  testStep("Step 2", "Enter Extended Diagnostic Session 0x03");

  rc = SetExtendedDiagnosticSession_VD(3000);
  if (rc != 0)
    testStepFail("Result 2", "SetExtendedDiagnosticSession_VD failed, rc=%d", rc);
  else
    testStepPass("Result 2", "Extended Diagnostic Session 0x03 active");

  testWaitForTimeout(300);

  /*======================================================
    STEP 3
    Read DID 0x3C0E in Extended Session
    Expected: 62 3C 0E 03 (Data = 0x03)
    Report: Data Bytes [1] 03 pass
  ======================================================*/
  testStep("Step 3", "Read DID 0x3C0E in Extended Session - expect 62 3C 0E 03");

  rawReq[0] = 0x22; rawReq[1] = 0x3C; rawReq[2] = 0x0E;
  diagResize(req, 3);
  diagSetPrimitiveData(req, rawReq, 3);
  diagSendRequest(req);
  testWaitForDiagResponse(req, 5000);
  rc = diagGetLastResponseCode(req);

  if (rc >= 0)
  {
    testStepFail("Result 3", "NRC=0x%02X received (expected positive 62 3C 0E 03)", rc);
  }
  else
  {
    diagGetLastResponse(req, resp);
    len = diagGetPrimitiveData(resp, readBuf, elcount(readBuf));
    if (len >= 4 && readBuf[0]==0x62 && readBuf[1]==0x3C && readBuf[2]==0x0E && readBuf[3]==0x03)
      testStepPass("Result 3", "DID 0x3C0E = 62 3C 0E 03 (Data=0x03) in Extended Session");
    else if (len >= 4)
      testStepFail("Result 3", "DID 0x3C0E = %02X %02X %02X %02X (expected 62 3C 0E 03)",
                   readBuf[0], readBuf[1], readBuf[2], readBuf[3]);
    else
      testStepFail("Result 3", "DID 0x3C0E read failed, len=%d", len);
  }

  testWaitForTimeout(250);

  /*======================================================
    STEP 4
    Enter Programming Session 0x02
    Report sequence: ClearDTC -> wait -> Extended -> SetExtendedSevice -> Programming
    SetProgrammingDiagnosticSession_VD() encapsulates Extended + SetExtendedSevice internally.
    UdsClearDTC_VD() called first as per report.
  ======================================================*/
  testStep("Step 4", "Enter Programming Session 0x02 (ClearDTC -> Extended -> Programming)");

  /* ClearDTC (all DTCs: group 0xFF FF FF) as per report */
  dtcGroup[0] = 0xFF; dtcGroup[1] = 0xFF; dtcGroup[2] = 0xFF;
  rc = UdsClearDTC_VD(dtcGroup, 3, 5000);
  if (rc != 0)
    write("WARNING: UdsClearDTC_VD returned %d (non-critical, continuing)", rc);

  testWaitForTimeout(3000);  /* report waits 3000ms after ClearDTC */

  /* Re-enter Extended before Programming */
  rc = SetExtendedDiagnosticSession_VD(3000);
  if (rc != 0) { testStepFail("Result 4", "Failed to enter Extended Session before Programming"); return; }

  testWaitForTimeout(250);

  /* Enter Programming — library uses SetExtendedSevice typed object internally */
  rc = SetProgrammingDiagnosticSession_VD(5000);
  if (rc != 0)
    testStepFail("Result 4", "SetProgrammingDiagnosticSession_VD failed, rc=%d", rc);
  else
    testStepPass("Result 4", "Programming Session 0x02 active");

  testWaitForTimeout(250);

  /*======================================================
    STEP 5
    Read DID 0x3C0E in Programming Session
    Expected: Negative Response (DID not available in Programming)
    Report: Negative response received — pass. No specific NRC checked.
  ======================================================*/
  testStep("Step 5", "Read DID 0x3C0E in Programming Session - expect Negative Response");

  rawReq[0] = 0x22; rawReq[1] = 0x3C; rawReq[2] = 0x0E;
  diagResize(req, 3);
  diagSetPrimitiveData(req, rawReq, 3);
  diagSendRequest(req);
  testWaitForDiagResponse(req, 5000);
  rc = diagGetLastResponseCode(req);

  if (rc >= 0)
  {
    /* Negative response: diagGetLastResponseCode returns NRC as positive value */
    receivedNRC = rc;
    write("TC_018 Step 5: NRC=0x%02X received as expected (DID not available in Programming)", receivedNRC);
    testStepPass("Result 5", "Negative response received (NRC=0x%02X) - DID 0x3C0E not available in Programming", receivedNRC);
  }
  else
  {
    /* Positive response — unexpected */
    diagGetLastResponse(req, resp);
    len = diagGetPrimitiveData(resp, readBuf, elcount(readBuf));
    testStepFail("Result 5", "Unexpected positive response in Programming Session, len=%d", len);
  }

  /*==========================================================
    POST-CONDITIONS
  ==========================================================*/
  testWaitForTimeout(500);

  /* Return to Default Session */
  SetDefaultDiagnosticSession_VD(3000);
  testWaitForTimeout(200);
  SetExtendedDiagnosticSession_VD(3000);

  testStepPass("Postcondition", "none");
  write("=== TC_HCP5_DIAG_11_018_DID_Protection_Method_0x3C0E_VD END ===");
}

void MainTest()
{
  TC_HCP5_DIAG_11_018_DID_Protection_Method_0x3C0E_VD();
}
