includes
{
  #include "../diaglibrary.cin"
  #include "../DiagLibraryAI.cin"
}

/*=============================================================================
  Test Case : TC_HCP5_DIAG_11_005_RID_Reset_0xC007_PD
  Source     : HCP5_SysTest
  Domain     : PD
  Purpose    : The test checks that RID 0xC007 (SFD Reset) is correctly
               implemented on PD. The routine must be rejected with NRC 0x31
               in Default Session, and must return a positive response in
               Extended Diagnostic Session when the SFD is unlocked. After
               the reset, DID 0x0174 is read to confirm the SFD state.

  Preconditions:
    1. Clamp 30 enabled
    2. Clamp 15 enabled
    3. Restbus simulation running (all ECUs transmit KN and NMH messages)
    4. Connect Diag Client to Diag-CAN
    5. Default Diagnostic Session 0x01

  Test Steps / Expected Results:
    1. Send RID 0xC007 StartRoutine (31 01 C0 07) in Default Session
       -> Negative response received with NRC 0x31
    2. Enter Extended Diagnostics Session 0x03, generate unlock token,
       unlock SFD via RID 0xC004
       -> SFD unlocked
    3. Send RID 0xC007 StartRoutine (31 01 C0 07) in Extended Session (SFD unlocked)
       -> Positive response received (71 01 C0 07 ...)
    4. Read DID 0x0174 in Extended Session
       -> Positive response received (SFD state after reset confirmed)

  Post-Conditions: none
=============================================================================*/
testcase TC_HCP5_DIAG_11_005_RID_Reset_0xC007_PD()
{
  diagRequest  HCP5_Diag_PD.RoutineResTknC007 req;
  diagResponse HCP5_Diag_PD.RoutineResTknC007 resp;

  diagRequest  HCP5_Diag_PD.SFD_Unlock req2;
  diagResponse HCP5_Diag_PD.SFD_Unlock resp2;

  byte routineData[1];
  byte response[4095];
  byte unlockBytes[4095];
  byte readBuf[4095];
  long rc;
  long respLen;
  long unlockLen;
  long len;
  long receivedNRC;

  write("=== TC_HCP5_DIAG_11_005_RID_Reset_0xC007_PD START ===");

  /*==========================================================
    PRECONDITIONS
  ==========================================================*/
  EnableClamp30();
  EnableClamp15();
  StartRestBusSimulation();
  testStepPass("Precondition", "Restbus simulation running (all ECUs transmit KN and NMH messages)");

  testWaitForTimeout(20000);  /* Wait for ECU boot after Klemme15 */

  ConnectDiagClientToDiagCAN();
  testStepPass("Precondition", "Diag client connected to Diag-CAN (PD)");

  testWaitForTimeout(500);

  rc = SetDefaultDiagnosticSession_PD(3000);
  if (rc != 0)
  {
    testStepFail("Precondition", "Failed to enter Default Diagnostic Session 0x01");
    return;
  }
  else
  {
    testStepPass("Precondition", "Default Diagnostic Session 0x01 entered");
  }

  testWaitForTimeout(500);

  /*======================================================
    STEP 1
    Send RID 0xC007 StartRoutine in Default Session
    Expected: Negative response received with NRC 0x31
  ======================================================*/
  testStep("Step 1", "Send RID 0xC007 StartRoutine (31 01 C0 07) in Default Session");

  respLen = SendRoutineControl(req, resp, 0x01, 0xC007, routineData, 0, response, elcount(response));

  if (respLen <= -256)
  {
    receivedNRC = (-respLen) - 256;
    if (receivedNRC == 0x31)
    {
      testStepPass("Result 1", "NRC 0x31 received as expected in Default Session");
    }
    else
    {
      testStepFail("Result 1", "Unexpected NRC. Expected 0x31, got 0x%02X", receivedNRC);
    }
  }
  else
  {
    testStepFail("Result 1", "Negative response with NRC 0x31 expected, got rc=%d", respLen);
  }

  testWaitForTimeout(500);

  /*======================================================
    STEP 2
    Enter Extended Diagnostics Session 0x03, generate unlock
    token, and unlock SFD via RID 0xC004
  ======================================================*/
  testStep("Step 2", "Enter Extended Session, generate unlock token, unlock SFD via RID 0xC004");

  rc = SetExtendedDiagnosticSession_PD(3000);
  if (rc != 0)
  {
    testStepFail("Result 2", "Failed to enter Extended Diagnostic Session 0x03");
    return;
  }
  else
  {
    testStepPass("Result 2", "Entered Extended Diagnostic Session 0x03");
  }

  testWaitForTimeout(500);

  rc = GenerateUnlocktoken_PD();
  if (rc != 0)
  {
    testStepFail("Result 2", "Failed to generate SFD unlock token");
    return;
  }
  else
  {
    testStepPass("Result 2", "SFD unlock token generated successfully");
  }

  testWaitForTimeout(500);

  write("DEBUG: gSfdUnlockToken value = '%s'", gSfdUnlockToken);
  write("DEBUG: gSfdUnlockToken length = %d", strlen(gSfdUnlockToken));

  unlockLen = HexStringToByteArray(gSfdUnlockToken, unlockBytes);

  write("DEBUG: HexStringToByteArray returned len = %d", unlockLen);

  if (unlockLen <= 0)
  {
    testStepFail("Result 2", "Failed to convert unlock token to byte array (len=%d)", unlockLen);
    return;
  }

  respLen = SendRoutineControl(req2, resp2, 0x01, 0xC004, unlockBytes, unlockLen, response, elcount(response));

  if (respLen > 0)
  {
    if (response[2] == 0xC0 && response[3] == 0x04)
    {
      testStepPass("Result 2", "SFD unlocked via RID 0xC004 - positive response received (71 01 C0 04)");
    }
    else
    {
      testStepFail("Result 2", "Unlock response content mismatch: response[2]=0x%02X response[3]=0x%02X", response[2], response[3]);
    }
  }
  else if (respLen <= -256)
  {
    receivedNRC = (-respLen) - 256;
    testStepFail("Result 2", "Negative response for SFD unlock RID 0xC004, NRC=0x%02X", receivedNRC);
    return;
  }
  else
  {
    testStepFail("Result 2", "SendRoutineControl RID 0xC004 (SFD Unlock) failed, rc=%d", respLen);
    return;
  }

  testWaitForTimeout(500);

  /*======================================================
    STEP 3
    Send RID 0xC007 StartRoutine in Extended Session (SFD unlocked)
    Expected: Positive response (71 01 C0 07 ...)
  ======================================================*/
  testStep("Step 3", "Send RID 0xC007 StartRoutine (31 01 C0 07) in Extended Session (SFD unlocked)");

  respLen = SendRoutineControl(req, resp, 0x01, 0xC007, routineData, 0, response, elcount(response));

  if (respLen > 0)
  {
    if (response[0] == 0x71 && response[2] == 0xC0 && response[3] == 0x07)
    {
      testStepPass("Result 3", "Positive response received for RID 0xC007 (71 01 C0 07), len=%d", respLen);
    }
    else
    {
      testStepFail("Result 3", "Response received but content mismatch: response[0]=0x%02X response[2]=0x%02X response[3]=0x%02X", response[0], response[2], response[3]);
    }
  }
  else if (respLen <= -256)
  {
    receivedNRC = (-respLen) - 256;
    testStepFail("Result 3", "Negative response received, NRC=0x%02X", receivedNRC);
  }
  else
  {
    testStepFail("Result 3", "SendRoutineControl RID 0xC007 failed, rc=%d", respLen);
  }

  /*======================================================
    STEP 4
    Read DID 0x0174 in Extended Session
    Expected: Positive response (SFD state after reset confirmed)
  ======================================================*/
  testStep("Step 4", "Read DID 0x0174 to confirm SFD state after reset");

  len = ReadDid_PD(0x0174, readBuf, elcount(readBuf));

  if (len > 0)
  {
    testStepPass("Result 4", "Positive response received for DID 0x0174 - SFD state after reset confirmed (len=%d)", len);
  }
  else if (len <= -256)
  {
    receivedNRC = (-len) - 256;
    testStepFail("Result 4", "Negative response received for DID 0x0174, NRC=0x%02X", receivedNRC);
  }
  else
  {
    testStepFail("Result 4", "Read DID 0x0174 failed, rc=%d", len);
  }

  /*==========================================================
    POST-CONDITIONS
  ==========================================================*/
  testStep("Postcondition", "none");

  write("=== TC_HCP5_DIAG_11_005_RID_Reset_0xC007_PD END ===");
}

void MainTest()
{
  TC_HCP5_DIAG_11_005_RID_Reset_0xC007_PD();
}
