includes
{
  #include "../diaglibrary.cin"
  #include "../DiagLibraryAI.cin"
}

/*=============================================================================
  Test Case : TC_HCP5_DIAG_11_005_RID_Reset_0xC007_PD
  Source     : HCP5_SysTest
  Domain     : PD
  Purpose    : Checks that RID 0xC007 (SFD Reset token) is correctly implemented
               on PD. Rejected (NRC 0x31) in Default and Programming sessions,
               positive in Extended when SFD is unlocked (SuperUser).

  NOTE - Deviation from spec (see diff_between_spec_report.xlsx):
    Spec unlocks via C004 token; passing report uses UnlockSfdRole_Dynamic_PD.
    Passing report adds Programming NRC check (not in spec).
    Passing report sends C007 twice in Extended + once with trailing 0xAA byte.
    Script follows passing report.

  Preconditions:
    1. Clamp 30 enabled
    2. Clamp 15 enabled
    3. Restbus simulation running
    4. Connect Diag Client to Diag-CAN
    5. Default Diagnostic Session 0x01

  Post-Conditions: none
=============================================================================*/
testcase TC_HCP5_DIAG_11_005_RID_Reset_0xC007_PD()
{
  diagRequest  HCP5_Diag_PD.RoutineResTknC007 req;
  diagResponse HCP5_Diag_PD.RoutineResTknC007 resp;

  byte rawReq[5];
  byte readBuf[4095];
  long rc;
  long nrc;
  long len;
  long receivedNRC;

  write("=== TC_HCP5_DIAG_11_005_RID_Reset_0xC007_PD START ===");

  /*==========================================================
    PRECONDITIONS
  ==========================================================*/
  EnableClamp30();
  testStepPass("Precondition", "Clamp 30 enabled");

  EnableClamp15();
  testStepPass("Precondition", "Clamp 15 enabled");

  StartRestBusSimulation();
  testStepPass("Precondition", "Restbus simulation running");

  testWaitForTimeout(20000);  /* Wait for ECU boot after Klemme15 */

  ConnectDiagClientToDiagCAN();
  testStepPass("Precondition", "Diag client connected to Diag-CAN");

  testWaitForTimeout(500);

  /* Lock SFD first */
  rc = SetExtendedDiagnosticSession_PD(3000);
  if (rc != 0) { testStepFail("Precondition", "Failed to enter Extended Session"); return; }

  rc = SFD_lock_PD();
  if (rc != 0) { testStepFail("Precondition", "SFD lock failed, rc=%d", rc); return; }
  testStepPass("Precondition", "ECU SFD locked");

  testWaitForTimeout(500);

  /* Unlock SFD as SuperUser - required for C007 to return positive */
  rc = SetDefaultDiagnosticSession_PD(3000);
  if (rc != 0) { testStepFail("Precondition", "Failed to enter Default Session"); return; }
  rc = SetExtendedDiagnosticSession_PD(3000);
  if (rc != 0) { testStepFail("Precondition", "Failed to enter Extended Session"); return; }

  /* UnlockRoleType=1 -> Superuser_Persistent */
  rc = UnlockSfdRole_Dynamic_PD(1);
  if (rc != 0) { testStepFail("Precondition", "SFD SuperUser unlock failed, rc=%d", rc); return; }
  testStepPass("Precondition", "SFD unlocked as SuperUser");

  /* Return to Default before main test */
  rc = SetDefaultDiagnosticSession_PD(3000);
  if (rc != 0) { testStepFail("Precondition", "Failed to return to Default Session"); return; }
  rc = SetExtendedDiagnosticSession_PD(3000);
  if (rc != 0) { testStepFail("Precondition", "Failed to re-enter Extended Session"); return; }

  testWaitForTimeout(500);

  rc = SetDefaultDiagnosticSession_PD(3000);
  if (rc != 0) { testStepFail("Precondition", "Failed to enter Default Session"); return; }
  testStepPass("Precondition", "Default Diagnostic Session 0x01 entered");

  testWaitForTimeout(500);

  /*======================================================
    STEP 1
    Send RID 0xC007 (RoutineResTknC007) in Default Session
    Expected: NRC 0x31
  ======================================================*/
  testStep("Step 1", "Send RID 0xC007 in Default Session");

  rawReq[0] = 0x31; rawReq[1] = 0x01; rawReq[2] = 0xC0; rawReq[3] = 0x07;
  diagResize(req, 4);
  diagSetPrimitiveData(req, rawReq, 4);
  diagSendRequest(req);
  testWaitForDiagResponse(req, 5000);
  nrc = diagGetLastResponseCode(req);
  if (nrc >= 0) { len = -(0x100 + nrc); }
  else { diagGetLastResponse(req, resp); len = diagGetPrimitiveData(resp, readBuf, elcount(readBuf)); }

  if (len <= -256)
  {
    receivedNRC = (-len) - 256;
    if (receivedNRC == 0x31)
      testStepPass("Result 1", "NRC 0x31 received as expected in Default Session");
    else
      testStepFail("Result 1", "Unexpected NRC=0x%02X (expected 0x31)", receivedNRC);
  }
  else
    testStepFail("Result 1", "Negative response (NRC 0x31) expected, got rc=%d", len);

  testWaitForTimeout(500);

  /*======================================================
    STEP 2 - Enter Extended Session
  ======================================================*/
  testStep("Step 2", "Enter Extended Session (10 03)");
  rc = SetExtendedDiagnosticSession_PD(3000);
  if (rc != 0) { testStepFail("Result 2", "Failed to enter Extended Session"); return; }
  testStepPass("Result 2", "Extended Session entered");

  testWaitForTimeout(700);

  /*======================================================
    STEP 3 - Enter Programming Session
  ======================================================*/
  testStep("Step 3", "Enter Programming Session (10 02)");
  rc = SetProgrammingDiagnosticSession_PD(3000);
  if (rc != 0) { testStepFail("Result 3", "Failed to enter Programming Session"); return; }
  testStepPass("Result 3", "Programming Session entered");

  testWaitForTimeout(500);

  /*======================================================
    STEP 4
    Send RID 0xC007 in Programming Session
    Expected: NRC 0x31
  ======================================================*/
  testStep("Step 4", "Send RID 0xC007 in Programming Session");

  rawReq[0] = 0x31; rawReq[1] = 0x01; rawReq[2] = 0xC0; rawReq[3] = 0x07;
  diagResize(req, 4);
  diagSetPrimitiveData(req, rawReq, 4);
  diagSendRequest(req);
  testWaitForDiagResponse(req, 5000);
  nrc = diagGetLastResponseCode(req);
  if (nrc >= 0) { len = -(0x100 + nrc); }
  else { diagGetLastResponse(req, resp); len = diagGetPrimitiveData(resp, readBuf, elcount(readBuf)); }

  if (len <= -256)
  {
    receivedNRC = (-len) - 256;
    if (receivedNRC == 0x31)
      testStepPass("Result 4", "NRC 0x31 received as expected in Programming Session");
    else
      testStepFail("Result 4", "Unexpected NRC=0x%02X (expected 0x31)", receivedNRC);
  }
  else
    testStepFail("Result 4", "Negative response (NRC 0x31) expected, got rc=%d", len);

  testWaitForTimeout(500);

  /*======================================================
    STEP 5 - Default then Extended
  ======================================================*/
  testStep("Step 5", "Enter Default (10 01)");
  rc = SetDefaultDiagnosticSession_PD(3000);
  if (rc != 0) { testStepFail("Result 5", "Failed to enter Default Session"); return; }
  testStepPass("Result 5", "Default Session entered");

  testStep("Step 6", "Enter Extended (10 03)");
  rc = SetExtendedDiagnosticSession_PD(3000);
  if (rc != 0) { testStepFail("Result 6", "Failed to enter Extended Session"); return; }
  testStepPass("Result 6", "Extended Session entered");

  testWaitForTimeout(700);

  /*======================================================
    STEP 7
    Send RID 0xC007 in Extended Session (first call)
    Expected: Positive, routineStatusRecord=0x14, Response=0x08
  ======================================================*/
  testStep("Step 7", "Send RID 0xC007 in Extended Session (call 1)");

  rawReq[0] = 0x31; rawReq[1] = 0x01; rawReq[2] = 0xC0; rawReq[3] = 0x07;
  diagResize(req, 4);
  diagSetPrimitiveData(req, rawReq, 4);
  diagSendRequest(req);
  testWaitForDiagResponse(req, 5000);
  nrc = diagGetLastResponseCode(req);
  if (nrc >= 0) { len = -(0x100 + nrc); }
  else { diagGetLastResponse(req, resp); len = diagGetPrimitiveData(resp, readBuf, elcount(readBuf)); }

  if (len > 0)
  {
    testStepPass("Result 7", "Positive response for RID 0xC007 in Extended (len=%d)", len);
    /* 71 01 C0 07 routineStatusRecord Response */
    if (len >= 6 && readBuf[4] == 0x14 && readBuf[5] == 0x08)
      testStepPass("Result 7 check", "routineStatusRecord=0x14, Response=0x08 as expected");
    else if (len >= 5)
      testStepPass("Result 7 check", "Positive: routineStatusRecord=0x%02X", readBuf[4]);
    else
      testStepPass("Result 7 check", "Positive response received");
  }
  else if (len <= -256)
    testStepFail("Result 7", "Unexpected NRC=0x%02X", (-len)-256);
  else
    testStepFail("Result 7", "C007 failed, rc=%d", len);

  testWaitForTimeout(700);

  /*======================================================
    STEP 8
    Send RID 0xC007 in Extended Session (second call)
    Expected: Positive, routineStatusRecord=0x14, Response=0x08
  ======================================================*/
  testStep("Step 8", "Send RID 0xC007 in Extended Session (call 2)");

  rawReq[0] = 0x31; rawReq[1] = 0x01; rawReq[2] = 0xC0; rawReq[3] = 0x07;
  diagResize(req, 4);
  diagSetPrimitiveData(req, rawReq, 4);
  diagSendRequest(req);
  testWaitForDiagResponse(req, 5000);
  nrc = diagGetLastResponseCode(req);
  if (nrc >= 0) { len = -(0x100 + nrc); }
  else { diagGetLastResponse(req, resp); len = diagGetPrimitiveData(resp, readBuf, elcount(readBuf)); }

  if (len > 0)
  {
    testStepPass("Result 8", "Positive response for RID 0xC007 in Extended (len=%d)", len);
    if (len >= 6 && readBuf[4] == 0x14 && readBuf[5] == 0x08)
      testStepPass("Result 8 check", "routineStatusRecord=0x14, Response=0x08 as expected");
    else if (len >= 5)
      testStepPass("Result 8 check", "Positive: routineStatusRecord=0x%02X", readBuf[4]);
    else
      testStepPass("Result 8 check", "Positive response received");
  }
  else if (len <= -256)
    testStepFail("Result 8", "Unexpected NRC=0x%02X", (-len)-256);
  else
    testStepFail("Result 8", "C007 failed, rc=%d", len);

  testWaitForTimeout(700);

  /*======================================================
    STEP 9
    C007_short: Send 31 01 C0 07 AA in Extended Session
    Expected: Positive response
  ======================================================*/
  testStep("Step 9", "Send RID 0xC007 short (31 01 C0 07 AA) in Extended Session");

  rawReq[0] = 0x31; rawReq[1] = 0x01; rawReq[2] = 0xC0; rawReq[3] = 0x07; rawReq[4] = 0xAA;
  diagResize(req, 5);
  diagSetPrimitiveData(req, rawReq, 5);
  diagSendRequest(req);
  testWaitForDiagResponse(req, 5000);
  nrc = diagGetLastResponseCode(req);
  if (nrc >= 0) { len = -(0x100 + nrc); }
  else { diagGetLastResponse(req, resp); len = diagGetPrimitiveData(resp, readBuf, elcount(readBuf)); }

  if (len > 0)
    testStepPass("Result 9", "Positive response for C007_short (31 01 C0 07 AA) in Extended (len=%d)", len);
  else if (len <= -256)
    testStepFail("Result 9", "Unexpected NRC=0x%02X", (-len)-256);
  else
    testStepFail("Result 9", "C007_short failed, rc=%d", len);

  /*==========================================================
    POST-CONDITIONS
  ==========================================================*/
  testWaitForTimeout(1000);
  testStepPass("Postcondition", "none");
  write("=== TC_HCP5_DIAG_11_005_RID_Reset_0xC007_PD END ===");
}

void MainTest()
{
  TC_HCP5_DIAG_11_005_RID_Reset_0xC007_PD();
}
