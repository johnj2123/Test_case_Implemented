includes
{
  #include "../diaglibrary.cin"
  #include "../DiagLibraryAI.cin"
}

/*=============================================================================
  Test Case : TC_HCP5_DIAG_11_002_DID_Protection_Method_0x3C0E_PD
  Source     : HCP5_SysTest
  Domain     : PD
  Purpose    : Checks that DID 0x3C0E (Protection Method) is readable in
               Default and Extended sessions, and rejected in Programming session.

  NOTE - Deviation from spec (see diff_between_spec_report.xlsx):
    Spec order: Default read -> Programming (NRC) -> Extended read.
    Passing report order: Default read -> Default read -> Extended read ->
    Extended read -> Programming (NRC).
    Script follows passing report order.

  Preconditions:
    1. Clamp 30 enabled
    2. Clamp 15 enabled
    3. Restbus simulation running
    4. Connect Diag Client to Diag-CAN
    5. ECU SFD locked
    6. Default Diagnostic Session 0x01

  Post-Conditions: none
=============================================================================*/
testcase TC_HCP5_DIAG_11_002_DID_Protection_Method_0x3C0E_PD()
{
  const dword TIMEOUT_MS = 5000;

  byte reqPayload[2];   /* DID bytes: 0x3C, 0x0E */
  byte respBuf[4095];   /* raw wire response: [0]=0x62 [1]=0x3C [2]=0x0E [3]=data */
  long rc;
  long receivedNRC;

  write("=== TC_HCP5_DIAG_11_002_DID_Protection_Method_0x3C0E_PD START ===");

  reqPayload[0] = 0x3C;
  reqPayload[1] = 0x0E;

  /*==========================================================
    PRECONDITIONS
  ==========================================================*/
  EnableClamp30();
  testStepPass("Precondition", "Enable Clamp 30");

  EnableClamp15();
  testStepPass("Precondition", "Enable Clamp 15");

  StartRestBusSimulation();
  testStepPass("Precondition", "Restbus simulation running");

  testWaitForTimeout(20000);

  ConnectDiagClientToDiagCAN();
  testStepPass("Precondition", "Diag client connected to Diag-CAN");

  testWaitForTimeout(500);

  rc = SetExtendedDiagnosticSession_PD(3000);
  if (rc != 0) { testStepFail("Precondition", "Failed to enter Extended Session for SFD lock"); return; }

  rc = SFD_lock_PD();
  if (rc != 0) { testStepFail("Precondition", "Failed to lock SFD, rc=%d", rc); return; }
  testStepPass("Precondition", "ECU SFD locked");

  testWaitForTimeout(500);

  rc = SetDefaultDiagnosticSession_PD(3000);
  if (rc != 0) { testStepFail("Precondition", "Failed to enter Default Session"); return; }
  testStepPass("Precondition", "Default Diagnostic Session 0x01 entered");

  testWaitForTimeout(500);

  /*======================================================
    STEP 1
    Read DID 0x3C0E in Default Session
    Expected: Positive response, Data = 0x03
  ======================================================*/
  testStep("Step 1", "Send the 0x3C0E reading request in Default Session");

  rc = Send_Generic_Diag_mutliRequest_PD(0x22, reqPayload, 2, TIMEOUT_MS, respBuf, elcount(respBuf));

  if (rc > 0)
  {
    testStepPass("Result 1", "Positive response received for DID 0x3C0E (len=%d)", rc);
    /* respBuf[0]=0x62, [1]=0x3C, [2]=0x0E, [3]=protection method value */
    if (respBuf[3] == 0x03)
      testStepPass("Result 1 check", "Data=0x03 as expected (62 3C 0E 03)");
    else
      testStepFail("Result 1 check", "Unexpected Data=0x%02X (expected 0x03)", respBuf[3]);
  }
  else if (rc <= -256)
  {
    receivedNRC = (-rc) - 256;
    testStepFail("Result 1", "NRC=0x%02X received (expected positive response)", receivedNRC);
  }
  else { testStepFail("Result 1", "Read failed, rc=%d", rc); }

  testWaitForTimeout(500);

  /*======================================================
    STEP 2
    Read DID 0x3C0E again in Default Session
    Expected: Positive response, Data = 0x03
  ======================================================*/
  testStep("Step 2", "Send the 0x3C0E reading request in Default Session (confirm)");

  rc = Send_Generic_Diag_mutliRequest_PD(0x22, reqPayload, 2, TIMEOUT_MS, respBuf, elcount(respBuf));

  if (rc > 0)
  {
    testStepPass("Result 2", "Positive response received for DID 0x3C0E (len=%d)", rc);
    if (respBuf[3] == 0x03)
      testStepPass("Result 2 check", "Data=0x03 as expected (62 3C 0E 03)");
    else
      testStepFail("Result 2 check", "Unexpected Data=0x%02X (expected 0x03)", respBuf[3]);
  }
  else if (rc <= -256)
  {
    receivedNRC = (-rc) - 256;
    testStepFail("Result 2", "NRC=0x%02X received (expected positive response)", receivedNRC);
  }
  else { testStepFail("Result 2", "Read failed, rc=%d", rc); }

  testWaitForTimeout(500);

  /*======================================================
    STEP 3
    Enter Extended Diagnostic Session 0x03
  ======================================================*/
  testStep("Step 3", "Enter Extended Diagnostic Session 0x03");

  rc = SetExtendedDiagnosticSession_PD(3000);
  if (rc != 0) { testStepFail("Result 3", "Failed to enter Extended Session"); return; }
  testStepPass("Result 3", "Extended Diagnostic Session 0x03 entered");

  testWaitForTimeout(500);

  /*======================================================
    STEP 4
    Read DID 0x3C0E in Extended Session
    Expected: Positive response, Data = 0x03
  ======================================================*/
  testStep("Step 4", "Send the 0x3C0E reading request in Extended Session");

  rc = Send_Generic_Diag_mutliRequest_PD(0x22, reqPayload, 2, TIMEOUT_MS, respBuf, elcount(respBuf));

  if (rc > 0)
  {
    testStepPass("Result 4", "Positive response received for DID 0x3C0E in Extended (len=%d)", rc);
    if (respBuf[3] == 0x03)
      testStepPass("Result 4 check", "Data=0x03 as expected (62 3C 0E 03)");
    else
      testStepFail("Result 4 check", "Unexpected Data=0x%02X (expected 0x03)", respBuf[3]);
  }
  else if (rc <= -256)
  {
    receivedNRC = (-rc) - 256;
    testStepFail("Result 4", "NRC=0x%02X received (expected positive response)", receivedNRC);
  }
  else { testStepFail("Result 4", "Read failed, rc=%d", rc); }

  testWaitForTimeout(500);

  /*======================================================
    STEP 5
    Re-enter Extended Diagnostic Session 0x03
  ======================================================*/
  testStep("Step 5", "Re-enter Extended Diagnostic Session 0x03");

  rc = SetExtendedDiagnosticSession_PD(3000);
  if (rc != 0) { testStepFail("Result 5", "Failed to re-enter Extended Session"); return; }
  testStepPass("Result 5", "Extended Diagnostic Session 0x03 confirmed");

  testWaitForTimeout(500);

  /*======================================================
    STEP 6
    Enter Programming Session 0x02
  ======================================================*/
  testStep("Step 6", "Enter Programming Session 0x02");

  rc = SetDefaultDiagnosticSession_PD(3000);
  if (rc != 0) { testStepFail("Result 6", "Failed to enter Default Session"); return; }

  rc = SetExtendedDiagnosticSession_PD(3000);
  if (rc != 0) { testStepFail("Result 6", "Failed to enter Extended Session"); return; }

  rc = SetProgrammingDiagnosticSession_PD(3000);
  if (rc != 0) { testStepFail("Result 6", "Failed to enter Programming Session 0x02"); return; }
  testStepPass("Result 6", "Programming Session 0x02 entered");

  testWaitForTimeout(500);

  /*======================================================
    STEP 7
    Read DID 0x3C0E in Programming Session
    Expected: Negative response NRC 0x31
  ======================================================*/
  testStep("Step 7", "Send the 0x3C0E reading request in Programming Session");

  rc = Send_Generic_Diag_mutliRequest_PD(0x22, reqPayload, 2, TIMEOUT_MS, respBuf, elcount(respBuf));

  if (rc <= -256)
  {
    receivedNRC = (-rc) - 256;
    if (receivedNRC == 0x31)
      testStepPass("Result 7", "Negative response received with NRC 0x31 as expected");
    else
      testStepFail("Result 7", "Unexpected NRC=0x%02X (expected 0x31)", receivedNRC);
  }
  else if (rc > 0)
    testStepFail("Result 7", "Positive response received (len=%d) — NRC 0x31 expected", rc);
  else
    testStepFail("Result 7", "Read failed, rc=%d", rc);

  /*==========================================================
    POST-CONDITIONS
  ==========================================================*/
  testWaitForTimeout(1000);
  testStepPass("Postcondition", "none");
  write("=== TC_HCP5_DIAG_11_002_DID_Protection_Method_0x3C0E_PD END ===");
}

/*=============================================================================
  Function : Send_Generic_Diag_mutliRequest_PD
  Purpose  : PD-domain generic/raw UDS sender. Uses wildcard diagRequest
             HCP5_Diag_PD.* so diagGetPrimitiveData returns true wire bytes.
  Returns  : >0              : total response length (incl. SID+DID bytes)
             -(0x100 + NRC)  : negative response
             -1              : invalid length
             -2              : timeout
             -3              : buffer too small
             -4              : resize/set failure
             -5              : send failure
             -6              : response retrieval failure
=============================================================================*/
long Send_Generic_Diag_mutliRequest_PD(
  byte    sid,
  byte    payload[],
  word    payloadLen,
  dword   timeoutMs,
  byte    response[],
  word    maxRespLen)
{
  diagRequest  HCP5_Diag_PD.* req;
  diagResponse HCP5_Diag_PD.* resp;

  byte  requestData[4095];
  long  reqLen;
  long  result;
  long  responseCode;
  long  actualRespLen;
  long  copiedRespLen;
  int   i;

  reqLen = payloadLen + 1;

  if ((reqLen <= 0) || (reqLen > elCount(requestData)))
  {
    write("DIAG_ERR_PD: Invalid request length: %d", reqLen);
    return -1;
  }

  if (maxRespLen == 0)
  {
    write("DIAG_ERR_PD: Output buffer size is zero.");
    return -3;
  }

  requestData[0] = sid;
  for (i = 0; i < payloadLen; i++)
    requestData[i + 1] = payload[i];

  result = diagResize(req, reqLen);
  if (result < 0) { write("DIAG_ERR_PD: diagResize failed, result=%d", result); return -4; }

  result = diagSetPrimitiveData(req, requestData, reqLen);
  if (result < 0) { write("DIAG_ERR_PD: diagSetPrimitiveData failed, result=%d", result); return -4; }

  result = diagSendRequest(req);
  if (result < 0) { write("DIAG_ERR_PD: diagSendRequest failed, result=%d", result); return -5; }

  result = testWaitForDiagResponse(req, timeoutMs);
  if (result == 0) { write("DIAG_ERR_PD: Timeout waiting for response."); return -2; }
  if (result < 0)  { write("DIAG_ERR_PD: Error during response wait, result=%d", result); return -6; }

  responseCode = diagGetLastResponseCode(req);
  if (responseCode != -1)
  {
    write("DIAG_NEG_PD: SID=0x%02X NRC=0x%02X", sid, responseCode);
    return -(0x100 + responseCode);
  }

  result = diagGetLastResponse(req, resp);
  if (result < 0) { write("DIAG_ERR_PD: diagGetLastResponse failed, result=%d", result); return -6; }

  actualRespLen = diagGetPrimitiveSize(resp);
  if (actualRespLen <= 0) { write("DIAG_ERR_PD: Invalid response length=%d", actualRespLen); return -6; }

  if (actualRespLen > maxRespLen) { write("DIAG_ERR_PD: Buffer too small, need=%d have=%d", actualRespLen, maxRespLen); return -3; }

  copiedRespLen = diagGetPrimitiveData(resp, response, maxRespLen);
  if (copiedRespLen < 0) { write("DIAG_ERR_PD: diagGetPrimitiveData failed, result=%d", copiedRespLen); return -6; }

  write("DIAG_OK_PD: SID=0x%02X len=%d [0]=0x%02X [1]=0x%02X [2]=0x%02X [3]=0x%02X",
    response[0], actualRespLen, response[0], response[1], response[2], response[3]);

  return actualRespLen;
}

void MainTest()
{
  TC_HCP5_DIAG_11_002_DID_Protection_Method_0x3C0E_PD();
}
