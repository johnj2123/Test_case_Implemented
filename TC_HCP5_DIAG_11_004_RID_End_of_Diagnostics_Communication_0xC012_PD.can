includes
{
  #include "../diaglibrary.cin"
  #include "../DiagLibraryAI.cin"
}

/*=============================================================================
  Test Case : TC_HCP5_DIAG_11_004_RID_End_of_Diagnostics_Communication_0xC012_PD
  Source     : HCP5_SysTest
  Domain     : PD
  Purpose    : The test checks that RID 0xC012 (End of Diagnostics Communication)
               is correctly implemented on PD. The routine must be rejected
               with NRC 0x31 in Default Session and in Programming Session,
               and must return a positive response in Extended Diagnostic Session.

  Preconditions:
    1. Clamp 30 enabled
    2. Clamp 15 enabled
    3. Restbus simulation running (all ECUs transmit KN and NMH messages)
    4. Connect Diag Client to Diag-CAN
    5. ECU SFD locked
    6. Default Diagnostic Session 0x01

  Test Steps / Expected Results:
    1. Send RID 0xC012 StartRoutine (31 01 C0 12) in Default Session
       -> Negative response received with NRC 0x31
    2. Enter Extended Diagnostics Session 0x03
       -> (session transition)
    3. Send RID 0xC012 StartRoutine (31 01 C0 12) in Extended Session
       -> Positive response received (71 01 C0 12 ...)
    4. Enter Programming Session 0x02
       -> (session transition)
    5. Send RID 0xC012 StartRoutine (31 01 C0 12) in Programming Session
       -> Negative response received with NRC 0x31

  Post-Conditions: none
=============================================================================*/
testcase TC_HCP5_DIAG_11_004_RID_End_of_Diagnostics_Communication_0xC012_PD()
{
  diagRequest  HCP5_Diag_PD.E2E_finish req;
  diagResponse HCP5_Diag_PD.E2E_finish resp;

  byte routineData[1];
  byte response[4095];
  long rc;
  long respLen;
  long receivedNRC;

  write("=== TC_HCP5_DIAG_11_004_RID_End_of_Diagnostics_Communication_0xC012_PD START ===");

  /*==========================================================
    PRECONDITIONS
  ==========================================================*/
  EnableClamp30();
  EnableClamp15();
  StartRestBusSimulation();
  testStepPass("Precondition", "Restbus simulation running (all ECUs transmit KN and NMH messages)");

  testWaitForTimeout(20000);  /* Wait for ECU boot after Klemme15 */

  ConnectDiagClientToDiagCAN();
  testStepPass("Precondition", "Diag client connected to Diag-CAN (PD)");

  testWaitForTimeout(500);

  rc = SetExtendedDiagnosticSession_PD(3000);
  if (rc != 0)
  {
    testStepFail("Precondition", "Failed to enter Extended Session for SFD lock");
    return;
  }

  rc = SFD_lock_PD();
  if (rc != 0)
  {
    testStepFail("Precondition", "Failed to lock SFD");
    return;
  }
  else
  {
    testStepPass("Precondition", "ECU SFD locked");
  }

  testWaitForTimeout(500);

  rc = SetDefaultDiagnosticSession_PD(3000);
  if (rc != 0)
  {
    testStepFail("Precondition", "Failed to enter Default Diagnostic Session 0x01");
    return;
  }
  else
  {
    testStepPass("Precondition", "Default Diagnostic Session 0x01 entered");
  }

  testWaitForTimeout(500);

  /*======================================================
    STEP 1
    Send RID 0xC012 StartRoutine in Default Session
    Expected: Negative response received with NRC 0x31
  ======================================================*/
  testStep("Step 1", "Send RID 0xC012 StartRoutine (31 01 C0 12) in Default Session");

  respLen = SendRoutineControl(req, resp, 0x01, 0xC012, routineData, 0, response, elcount(response));

  if (respLen <= -256)
  {
    receivedNRC = (-respLen) - 256;
    if (receivedNRC == 0x31)
    {
      testStepPass("Result 1", "NRC 0x31 received as expected in Default Session");
    }
    else
    {
      testStepFail("Result 1", "Unexpected NRC. Expected 0x31, got 0x%02X", receivedNRC);
    }
  }
  else
  {
    testStepFail("Result 1", "Negative response with NRC 0x31 expected, got rc=%d", respLen);
  }

  testWaitForTimeout(500);

  /*======================================================
    STEP 2
    Enter Extended Diagnostics Session 0x03
  ======================================================*/
  testStep("Step 2", "Enter Extended Diagnostics Session 0x03");

  rc = SetExtendedDiagnosticSession_PD(3000);
  if (rc != 0)
  {
    testStepFail("Result 2", "Failed to enter Extended Diagnostic Session 0x03");
    return;
  }
  else
  {
    testStepPass("Result 2", "Entered Extended Diagnostic Session 0x03");
  }

  testWaitForTimeout(500);

  /*======================================================
    STEP 3
    Send RID 0xC012 StartRoutine in Extended Session
    Expected: Positive response (71 01 C0 12 ...)
  ======================================================*/
  testStep("Step 3", "Send RID 0xC012 StartRoutine (31 01 C0 12) in Extended Session");

  respLen = SendRoutineControl(req, resp, 0x01, 0xC012, routineData, 0, response, elcount(response));

  if (respLen > 0)
  {
    if (response[0] == 0x71 && response[2] == 0xC0 && response[3] == 0x12)
    {
      testStepPass("Result 3", "Positive response received for RID 0xC012 (71 01 C0 12), len=%d", respLen);
    }
    else
    {
      testStepFail("Result 3", "Response received but content mismatch: response[0]=0x%02X response[2]=0x%02X response[3]=0x%02X", response[0], response[2], response[3]);
    }
  }
  else if (respLen <= -256)
  {
    receivedNRC = (-respLen) - 256;
    testStepFail("Result 3", "Negative response received, NRC=0x%02X", receivedNRC);
  }
  else
  {
    testStepFail("Result 3", "SendRoutineControl RID 0xC012 failed, rc=%d", respLen);
  }

  testWaitForTimeout(500);

  /*======================================================
    STEP 4
    Enter Programming Session 0x02
  ======================================================*/
  testStep("Step 4", "Enter Programming Session 0x02");

  rc = SetExtendedDiagnosticSession_PD(3000);
  if (rc != 0)
  {
    testStepFail("Result 4", "Failed to enter Extended Session before Programming Session");
    return;
  }

  rc = SetProgrammingDiagnosticSession_PD(3000);
  if (rc != 0)
  {
    testStepFail("Result 4", "Failed to enter Programming Session 0x02");
    return;
  }
  else
  {
    testStepPass("Result 4", "Entered Programming Session 0x02");
  }

  testWaitForTimeout(500);

  /*======================================================
    STEP 5
    Send RID 0xC012 StartRoutine in Programming Session
    Expected: Negative response received with NRC 0x31
  ======================================================*/
  testStep("Step 5", "Send RID 0xC012 StartRoutine (31 01 C0 12) in Programming Session");

  respLen = SendRoutineControl(req, resp, 0x01, 0xC012, routineData, 0, response, elcount(response));

  if (respLen <= -256)
  {
    receivedNRC = (-respLen) - 256;
    if (receivedNRC == 0x31)
    {
      testStepPass("Result 5", "NRC 0x31 received as expected in Programming Session");
    }
    else
    {
      testStepFail("Result 5", "Unexpected NRC. Expected 0x31, got 0x%02X", receivedNRC);
    }
  }
  else
  {
    testStepFail("Result 5", "Negative response with NRC 0x31 expected, got rc=%d", respLen);
  }

  /*==========================================================
    POST-CONDITIONS
  ==========================================================*/
  testWaitForTimeout(1000);

  testStep("Postcondition", "none");

  write("=== TC_HCP5_DIAG_11_004_RID_End_of_Diagnostics_Communication_0xC012_PD END ===");
}

void MainTest()
{
  TC_HCP5_DIAG_11_004_RID_End_of_Diagnostics_Communication_0xC012_PD();
}
