includes
{
  #include "../diaglibrary.cin"
  #include "../DiagLibraryAI.cin"
}

/*=============================================================================
  Test Case : TC_HCP5_DIAG_11_002_DID_Protection_Method_$3C0E_PD
  Source     : HCP5_SysTest
  Domain     : PD
  Purpose    : The test checks that the content of the DID 0x3C0E Protection
               Method is correctly implemented on PD, and that it can only be
               read in Default and Extended Diagnostic Session (not in
               Programming Session).

  Preconditions:
    1. Clamp 30 enabled
    2. Clamp 15 enabled
    3. Restbus simulation running (all ECUs transmit KN and NMH messages)
    4. Connect Diag Client to Diag-CAN
    5. ECU SFD locked
    6. Default Diagnostic Session 0x01

  Test Steps / Expected Results:
    1. Send the $3C0E reading request (0x22) in Default Session
       -> Positive response received
    2. Enter Programming Session 0x02
       -> (session transition)
    3. Send the $3C0E reading request (0x22) in Programming Session
       -> Negative response received with NRC 0x31
    4. Enter Extended Diagnostics Session 0x03
       -> (session transition)
    5. Send the $3C0E reading request (0x22) in Extended Session
       -> Positive response received

  Post-Conditions: none
=============================================================================*/
testcase TC_HCP5_DIAG_11_002_DID_Protection_Method_$3C0E_PD()
{
  diagRequest  HCP5_Diag_PD.* req;
  diagResponse HCP5_Diag_PD.* resp;

  byte readBuf[4095];
  long rc;
  long len;
  long receivedNRC;

  write("=== TC_HCP5_DIAG_11_002_DID_Protection_Method_$3C0E_PD START ===");

  /*==========================================================
    PRECONDITIONS
  ==========================================================*/
  EnableClamp30();
  EnableClamp15();
  StartRestBusSimulation();
  testStepPass("Precondition", "Restbus simulation running (all ECUs transmit KN and NMH messages)");

  ConnectDiagClientToDiagCAN();
  testStepPass("Precondition", "Diag client connected to Diag-CAN (PD)");

  rc = SetExtendedDiagnosticSession_PD(3000);
  if (rc != 0)
  {
    testStepFail("Precondition", "Failed to enter Extended Session for SFD lock");
    return;
  }

  rc = SFD_lock();
  if (rc != 0)
  {
    testStepFail("Precondition", "Failed to lock SFD");
    return;
  }
  else
  {
    testStepPass("Precondition", "ECU SFD locked");
  }

  rc = SetDefaultDiagnosticSession_PD(3000);
  if (rc != 0)
  {
    testStepFail("Precondition", "Failed to enter Default Diagnostic Session 0x01");
    return;
  }
  else
  {
    testStepPass("Precondition", "Default Diagnostic Session 0x01 entered");
  }

  /*======================================================
    STEP 1
    Send the $3C0E reading request (0x22) in Default Session
    Expected: Positive response received
  ======================================================*/
  testStep("Step 1", "Send the $3C0E reading request in Default Session");

  len = UdsReadDid(0x3C0E, req, resp, readBuf, elcount(readBuf), 5000);

  if (len > 0)
  {
    testStepPass("Result 1", "Positive response received for DID 0x3C0E (len=%d)", len);
  }
  else if (len <= -256)
  {
    receivedNRC = (-len) - 256;
    testStepFail("Result 1", "Negative response received, NRC=0x%02X", receivedNRC);
  }
  else
  {
    testStepFail("Result 1", "Read DID 0x3C0E failed, rc=%d", len);
  }

  /*======================================================
    STEP 2
    Enter Programming Session 0x02
  ======================================================*/
  testStep("Step 2", "Enter Programming Session 0x02");

  rc = SetProgrammingDiagnosticSession_PD(3000);
  if (rc != 0)
  {
    testStepFail("Result 2", "Failed to enter Programming Session 0x02");
    return;
  }
  else
  {
    testStepPass("Result 2", "Entered Programming Session 0x02");
  }

  /*======================================================
    STEP 3
    Send the $3C0E reading request (0x22) in Programming Session
    Expected: Negative response received with NRC 0x31
  ======================================================*/
  testStep("Step 3", "Send the $3C0E reading request in Programming Session");

  len = UdsReadDid(0x3C0E, req, resp, readBuf, elcount(readBuf), 5000);

  if (len <= -256)
  {
    receivedNRC = (-len) - 256;
    if (receivedNRC == 0x31)
    {
      testStepPass("Result 3", "NRC 0x31 received as expected");
    }
    else
    {
      testStepFail("Result 3", "Unexpected NRC. Expected 0x31, got 0x%02X", receivedNRC);
    }
  }
  else
  {
    testStepFail("Result 3", "Negative response with NRC 0x31 expected, got rc=%d", len);
  }

  /*======================================================
    STEP 4
    Enter Extended Diagnostics Session 0x03
  ======================================================*/
  testStep("Step 4", "Enter Extended Diagnostics Session 0x03");

  rc = SetDefaultDiagnosticSession_PD(3000);
  if (rc != 0)
  {
    testStepFail("Result 4", "Failed to enter Default Session before Extended Session");
    return;
  }

  rc = SetExtendedDiagnosticSession_PD(3000);
  if (rc != 0)
  {
    testStepFail("Result 4", "Failed to enter Extended Diagnostic Session 0x03");
    return;
  }
  else
  {
    testStepPass("Result 4", "Entered Extended Diagnostic Session 0x03");
  }

  /*======================================================
    STEP 5
    Send the $3C0E reading request (0x22) in Extended Session
    Expected: Positive response received
  ======================================================*/
  testStep("Step 5", "Send the $3C0E reading request in Extended Session");

  len = UdsReadDid(0x3C0E, req, resp, readBuf, elcount(readBuf), 5000);

  if (len > 0)
  {
    testStepPass("Result 5", "Positive response received for DID 0x3C0E (len=%d)", len);
  }
  else if (len <= -256)
  {
    receivedNRC = (-len) - 256;
    testStepFail("Result 5", "Negative response received, NRC=0x%02X", receivedNRC);
  }
  else
  {
    testStepFail("Result 5", "Read DID 0x3C0E failed, rc=%d", len);
  }

  /*==========================================================
    POST-CONDITIONS
  ==========================================================*/
  testStep("Postcondition", "none");

  write("=== TC_HCP5_DIAG_11_002_DID_Protection_Method_$3C0E_PD END ===");
}

void MainTest()
{
  TC_HCP5_DIAG_11_002_DID_Protection_Method_$3C0E_PD();
}
