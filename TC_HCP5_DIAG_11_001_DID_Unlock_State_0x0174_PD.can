includes
{
  #include "../diaglibrary.cin"
  #include "../DiagLibraryAI.cin"
}

/*=============================================================================
  Test Case : TC_HCP5_DIAG_11_001_DID_Unlock_State_0x0174_PD
  Source     : HCP5_SysTest (HCP5_SysTest18414)
  Domain     : PD
  Purpose    : Checks that DID 0x0174 (Unlock_status_of_ECU_of_protection_of_
               vehicle_diagnosis) correctly reflects the current SFD unlock
               state for each role.

  NOTE - Deviation from spec (see diff_between_spec_report.xlsx):
    Spec says read DID in current session (Default for steps 1,3,6,9).
    ECU returns only 6 bytes without persistence flag in Default session.
    Passing reference script always enters Extended session before DID read.
    This script follows the passing reference script behaviour:
      Default -> Extended -> Read DID 0x0174 -> stay in Extended

  Preconditions:
    1. Clamp 30 enabled
    2. Clamp 15 enabled
    3. Restbus simulation running
    4. Connect Diag Client to Diag-CAN
    5. ECU SFD locked
    6. Default Diagnostic Session 0x01

  Post-Conditions:
    ECU unlocked

  Role -> UnlockRoleType sysvar mapping:
    1 = Superuser_Persistent
    2 = Production_Persistent
    3 = Extended_Persistent
    4 = Basic_Persistent
=============================================================================*/
testcase TC_HCP5_DIAG_11_001_DID_Unlock_State_0x0174_PD()
{
  diagRequest  HCP5_Diag_PD.SFD_Lock lockReq;
  diagResponse HCP5_Diag_PD.SFD_Lock lockResp;
  diagRequest  HCP5_Diag_PD.* didReq;
  diagResponse HCP5_Diag_PD.* didResp;

  byte readBuf[4095];
  byte reqRaw[3];
  byte lockData[1];
  byte lockResp_raw[4095];
  long rc;
  long len;
  long lockLen;
  long receivedNRC;
  long nrc;

  write("=== TC_HCP5_DIAG_11_001_DID_Unlock_State_0x0174_PD START ===");

  /*==========================================================
    PRECONDITIONS
  ==========================================================*/
  EnableClamp30();
  testStepPass("Precondition", "Enable Clamp 30");

  EnableClamp15();
  testStepPass("Precondition", "Enable Clamp 15");

  StartRestBusSimulation();
  testStepPass("Precondition", "Restbus simulation running");

  testWaitForTimeout(20000);  /* Wait for ECU boot after Klemme15 */

  ConnectDiagClientToDiagCAN();
  testStepPass("Precondition", "Diag client connected to Diag-CAN");

  testWaitForTimeout(500);

  /* Enter Extended to allow SFD lock */
  rc = SetExtendedDiagnosticSession_PD(3000);
  if (rc != 0) { testStepFail("Precondition", "Failed to enter Extended Session"); return; }

  testWaitForTimeout(500);

  rc = SFD_lock_PD();
  if (rc != 0) { testStepFail("Precondition", "Failed to lock SFD, rc=%d", rc); return; }
  testStepPass("Precondition", "ECU SFD locked");

  testWaitForTimeout(500);

  rc = SetDefaultDiagnosticSession_PD(3000);
  if (rc != 0) { testStepFail("Precondition", "Failed to enter Default Session"); return; }
  testStepPass("Precondition", "Default Diagnostic Session 0x01 entered");

  testWaitForTimeout(500);

  /*==========================================================
    STEP 1 - Read DID 0x0174 (SFD locked)
    Expected: 62 01 74 00 00 01 00
    Note: Enter Extended before read (ref. passing script behaviour)
  ==========================================================*/
  testStep("Step 1", "Read DID 0x0174 - ECU SFD locked");

  SetDefaultDiagnosticSession_PD(3000);
  SetExtendedDiagnosticSession_PD(3000);

  reqRaw[0] = 0x22; reqRaw[1] = 0x01; reqRaw[2] = 0x74;
  diagResize(didReq, 3);
  diagSetPrimitiveData(didReq, reqRaw, 3);
  diagSendRequest(didReq);
  testWaitForDiagResponse(didReq, 5000);
  nrc = diagGetLastResponseCode(didReq);
  if (nrc >= 0) { len = -(0x100 + nrc); }
  else { diagGetLastResponse(didReq, didResp); len = diagGetPrimitiveData(didResp, readBuf, elcount(readBuf)); }

  if (len > 0)
  {
    testStepPass("Result 1", "Positive response: 62 01 74 %02X %02X %02X %02X (len=%d)",
      readBuf[3], readBuf[4], readBuf[5], readBuf[6], len);
    if (readBuf[3] == 0x00 && readBuf[6] == 0x00)
      testStepPass("Result 1 check", "State=0x00 (locked), Type=0x00 as expected");
    else
      testStepFail("Result 1 check",
        "Unexpected: readBuf[3]=0x%02X readBuf[6]=0x%02X (expected 0x00 / 0x00)",
        readBuf[3], readBuf[6]);
  }
  else if (len <= -256) { testStepFail("Result 1", "NRC=0x%02X", (-len)-256); }
  else { testStepFail("Result 1", "Read failed, rc=%d", len); }

  testWaitForTimeout(500);

  /*==========================================================
    STEP 2 - Unlock SFD with BASIC Role (persistent)
  ==========================================================*/
  testStep("Step 2", "SFD UnLock Basic Starting");

  /* UnlockSfdRole_PD internally enters Extended session */
  @sysvar::SFDRequest::UnlockRoleType = 4;  /* Basic_Persistent */
  rc = UnlockSfdRole_PD();
  if (rc != 0) { testStepFail("Result 2", "SFD Basic unlock failed, rc=%d", rc); return; }
  testStepPass("Result 2", "SFD unlocked with BASIC Role (persistent)");

  testWaitForTimeout(500);

  /*==========================================================
    STEP 3 - Read DID 0x0174 (Basic unlocked)
    Expected: 62 01 74 02 03 01 FF
  ==========================================================*/
  testStep("Step 3", "Read DID 0x0174 - BASIC Role unlocked");

  SetDefaultDiagnosticSession_PD(3000);
  SetExtendedDiagnosticSession_PD(3000);

  reqRaw[0] = 0x22; reqRaw[1] = 0x01; reqRaw[2] = 0x74;
  diagResize(didReq, 3);
  diagSetPrimitiveData(didReq, reqRaw, 3);
  diagSendRequest(didReq);
  testWaitForDiagResponse(didReq, 5000);
  nrc = diagGetLastResponseCode(didReq);
  if (nrc >= 0) { len = -(0x100 + nrc); }
  else { diagGetLastResponse(didReq, didResp); len = diagGetPrimitiveData(didResp, readBuf, elcount(readBuf)); }

  if (len > 0)
  {
    testStepPass("Result 3", "Positive response: 62 01 74 %02X %02X %02X %02X (len=%d)",
      readBuf[3], readBuf[4], readBuf[5], readBuf[6], len);
    if (readBuf[3] == 0x02 && readBuf[6] == 0xFF)
      testStepPass("Result 3 check", "State=0x02 (Basic), persistent=0xFF as expected");
    else
      testStepFail("Result 3 check",
        "Unexpected: readBuf[3]=0x%02X readBuf[6]=0x%02X (expected 0x02 / 0xFF)",
        readBuf[3], readBuf[6]);
  }
  else if (len <= -256) { testStepFail("Result 3", "NRC=0x%02X", (-len)-256); }
  else { testStepFail("Result 3", "Read failed, rc=%d", len); }

  testWaitForTimeout(500);

  /*==========================================================
    STEP 4 - Lock SFD
  ==========================================================*/
  testStep("Step 4", "SFD Lock Starting");

  rc = SFD_lock_PD();
  if (rc != 0) { testStepFail("Result 4", "SFD lock failed, rc=%d", rc); return; }
  testStepPass("Result 4", "ECU SFD Locked");

  testWaitForTimeout(500);

  /*==========================================================
    STEP 5 - Unlock SFD with EXTENDED Role (persistent)
  ==========================================================*/
  testStep("Step 5", "SFD UnLock Extended Starting");

  @sysvar::SFDRequest::UnlockRoleType = 3;  /* Extended_Persistent */
  rc = UnlockSfdRole_PD();
  if (rc != 0) { testStepFail("Result 5", "SFD Extended unlock failed, rc=%d", rc); return; }
  testStepPass("Result 5", "SFD unlocked with EXTENDED Role (persistent)");

  testWaitForTimeout(500);

  /*==========================================================
    STEP 6 - Read DID 0x0174 (Extended unlocked)
    Expected: 62 01 74 03 03 01 FF
  ==========================================================*/
  testStep("Step 6", "Read DID 0x0174 - EXTENDED Role unlocked");

  SetDefaultDiagnosticSession_PD(3000);
  SetExtendedDiagnosticSession_PD(3000);

  reqRaw[0] = 0x22; reqRaw[1] = 0x01; reqRaw[2] = 0x74;
  diagResize(didReq, 3);
  diagSetPrimitiveData(didReq, reqRaw, 3);
  diagSendRequest(didReq);
  testWaitForDiagResponse(didReq, 5000);
  nrc = diagGetLastResponseCode(didReq);
  if (nrc >= 0) { len = -(0x100 + nrc); }
  else { diagGetLastResponse(didReq, didResp); len = diagGetPrimitiveData(didResp, readBuf, elcount(readBuf)); }

  if (len > 0)
  {
    testStepPass("Result 6", "Positive response: 62 01 74 %02X %02X %02X %02X (len=%d)",
      readBuf[3], readBuf[4], readBuf[5], readBuf[6], len);
    if (readBuf[3] == 0x03 && readBuf[6] == 0xFF)
      testStepPass("Result 6 check", "State=0x03 (Extended), persistent=0xFF as expected");
    else
      testStepFail("Result 6 check",
        "Unexpected: readBuf[3]=0x%02X readBuf[6]=0x%02X (expected 0x03 / 0xFF)",
        readBuf[3], readBuf[6]);
  }
  else if (len <= -256) { testStepFail("Result 6", "NRC=0x%02X", (-len)-256); }
  else { testStepFail("Result 6", "Read failed, rc=%d", len); }

  testWaitForTimeout(500);

  /*==========================================================
    STEP 7 - Lock SFD
  ==========================================================*/
  testStep("Step 7", "SFD Lock Starting");

  rc = SFD_lock_PD();
  if (rc != 0) { testStepFail("Result 7", "SFD lock failed, rc=%d", rc); return; }
  testStepPass("Result 7", "ECU SFD Locked");

  testWaitForTimeout(500);

  /*==========================================================
    STEP 8 - Unlock SFD with SUPERUSER Role (persistent)
  ==========================================================*/
  testStep("Step 8", "SFD UnLock SuperUser Starting");

  @sysvar::SFDRequest::UnlockRoleType = 1;  /* Superuser_Persistent */
  rc = UnlockSfdRole_PD();
  if (rc != 0) { testStepFail("Result 8", "SFD Superuser unlock failed, rc=%d", rc); return; }
  testStepPass("Result 8", "SFD unlocked with SUPERUSER Role (persistent)");

  testWaitForTimeout(500);

  /*==========================================================
    STEP 9 - Read DID 0x0174 (Superuser unlocked)
    Expected: 62 01 74 04 03 01 FF
  ==========================================================*/
  testStep("Step 9", "Read DID 0x0174 - SUPERUSER Role unlocked");

  SetDefaultDiagnosticSession_PD(3000);
  SetExtendedDiagnosticSession_PD(3000);

  reqRaw[0] = 0x22; reqRaw[1] = 0x01; reqRaw[2] = 0x74;
  diagResize(didReq, 3);
  diagSetPrimitiveData(didReq, reqRaw, 3);
  diagSendRequest(didReq);
  testWaitForDiagResponse(didReq, 5000);
  nrc = diagGetLastResponseCode(didReq);
  if (nrc >= 0) { len = -(0x100 + nrc); }
  else { diagGetLastResponse(didReq, didResp); len = diagGetPrimitiveData(didResp, readBuf, elcount(readBuf)); }

  if (len > 0)
  {
    testStepPass("Result 9", "Positive response: 62 01 74 %02X %02X %02X %02X (len=%d)",
      readBuf[3], readBuf[4], readBuf[5], readBuf[6], len);
    if (readBuf[3] == 0x04 && readBuf[6] == 0xFF)
      testStepPass("Result 9 check", "State=0x04 (Superuser), persistent=0xFF as expected");
    else
      testStepFail("Result 9 check",
        "Unexpected: readBuf[3]=0x%02X readBuf[6]=0x%02X (expected 0x04 / 0xFF)",
        readBuf[3], readBuf[6]);
  }
  else if (len <= -256) { testStepFail("Result 9", "NRC=0x%02X", (-len)-256); }
  else { testStepFail("Result 9", "Read failed, rc=%d", len); }

  testWaitForTimeout(500);

  /*==========================================================
    STEP 10 - Enter Extended Diagnostic Session 0x03
  ==========================================================*/
  testStep("Step 10", "Enter Extended Diagnostic Session 0x03");

  rc = SetExtendedDiagnosticSession_PD(3000);
  if (rc != 0) { testStepFail("Result 10", "Failed to enter Extended Session"); return; }
  testStepPass("Result 10", "Extended Diagnostic Session 0x03 entered");

  testWaitForTimeout(500);

  /*==========================================================
    STEP 11 - Read DID 0x0174 in Extended Session (Superuser still active)
    Expected: 62 01 74 04 03 01 FF
  ==========================================================*/
  testStep("Step 11", "Read DID 0x0174 - SUPERUSER still active in Extended Session");

  reqRaw[0] = 0x22; reqRaw[1] = 0x01; reqRaw[2] = 0x74;
  diagResize(didReq, 3);
  diagSetPrimitiveData(didReq, reqRaw, 3);
  diagSendRequest(didReq);
  testWaitForDiagResponse(didReq, 5000);
  nrc = diagGetLastResponseCode(didReq);
  if (nrc >= 0) { len = -(0x100 + nrc); }
  else { diagGetLastResponse(didReq, didResp); len = diagGetPrimitiveData(didResp, readBuf, elcount(readBuf)); }

  if (len > 0)
  {
    testStepPass("Result 11", "Positive response: 62 01 74 %02X %02X %02X %02X (len=%d)",
      readBuf[3], readBuf[4], readBuf[5], readBuf[6], len);
    if (readBuf[3] == 0x04 && readBuf[6] == 0xFF)
      testStepPass("Result 11 check", "State=0x04 (Superuser) persists in Extended Session as expected");
    else
      testStepFail("Result 11 check",
        "Unexpected: readBuf[3]=0x%02X readBuf[6]=0x%02X (expected 0x04 / 0xFF)",
        readBuf[3], readBuf[6]);
  }
  else if (len <= -256) { testStepFail("Result 11", "NRC=0x%02X", (-len)-256); }
  else { testStepFail("Result 11", "Read failed, rc=%d", len); }

  testWaitForTimeout(500);

  /*==========================================================
    STEP 12 - Lock SFD
  ==========================================================*/
  testStep("Step 12", "SFD Lock Starting");

  rc = SFD_lock_PD();
  if (rc != 0) { testStepFail("Result 12", "SFD lock failed, rc=%d", rc); return; }
  testStepPass("Result 12", "ECU SFD Locked");

  testWaitForTimeout(500);

  /*==========================================================
    STEP 13 - Enter Default Diagnostic Session 0x01
  ==========================================================*/
  testStep("Step 13", "Enter Default Diagnostic Session 0x01");

  rc = SetDefaultDiagnosticSession_PD(3000);
  if (rc != 0) { testStepFail("Result 13", "Failed to enter Default Session"); return; }
  testStepPass("Result 13", "Default Diagnostic Session 0x01 entered");

  testWaitForTimeout(500);

  /*==========================================================
    STEP 14 - Unlock SFD with PRODUCTION Role (persistent)
  ==========================================================*/
  testStep("Step 14", "SFD UnLock Production Persistent Starting");

  @sysvar::SFDRequest::UnlockRoleType = 2;  /* Production_Persistent */
  rc = UnlockSfdRole_PD();
  if (rc != 0) { testStepFail("Result 14", "SFD Production unlock failed, rc=%d", rc); return; }
  testStepPass("Result 14", "SFD unlocked with PRODUCTION Role (persistent)");

  testWaitForTimeout(500);

  /*==========================================================
    STEP 15 - Read DID 0x0174 (Production unlocked)
    Expected: 62 01 74 05 03 01 FF
  ==========================================================*/
  testStep("Step 15", "Read DID 0x0174 - PRODUCTION Role unlocked");

  SetDefaultDiagnosticSession_PD(3000);
  SetExtendedDiagnosticSession_PD(3000);

  reqRaw[0] = 0x22; reqRaw[1] = 0x01; reqRaw[2] = 0x74;
  diagResize(didReq, 3);
  diagSetPrimitiveData(didReq, reqRaw, 3);
  diagSendRequest(didReq);
  testWaitForDiagResponse(didReq, 5000);
  nrc = diagGetLastResponseCode(didReq);
  if (nrc >= 0) { len = -(0x100 + nrc); }
  else { diagGetLastResponse(didReq, didResp); len = diagGetPrimitiveData(didResp, readBuf, elcount(readBuf)); }

  if (len > 0)
  {
    testStepPass("Result 15", "Positive response: 62 01 74 %02X %02X %02X %02X (len=%d)",
      readBuf[3], readBuf[4], readBuf[5], readBuf[6], len);
    if (readBuf[3] == 0x05 && readBuf[6] == 0xFF)
      testStepPass("Result 15 check", "State=0x05 (Production), persistent=0xFF as expected");
    else
      testStepFail("Result 15 check",
        "Unexpected: readBuf[3]=0x%02X readBuf[6]=0x%02X (expected 0x05 / 0xFF)",
        readBuf[3], readBuf[6]);
  }
  else if (len <= -256) { testStepFail("Result 15", "NRC=0x%02X", (-len)-256); }
  else { testStepFail("Result 15", "Read failed, rc=%d", len); }

  testWaitForTimeout(500);

  /*==========================================================
    STEP 16 - Lock SFD
  ==========================================================*/
  testStep("Step 16", "SFD Lock Starting");

  rc = SFD_lock_PD();
  if (rc != 0) { testStepFail("Result 16", "SFD lock failed, rc=%d", rc); return; }
  testStepPass("Result 16", "ECU SFD Locked");

  testWaitForTimeout(500);

  /*==========================================================
    STEP 17 - Unlock SFD with OTA Role (persistent)
    NOTE: OTA role type value not confirmed. Using UnlockRoleType=7
    as placeholder - update if dedicated OTA type is defined.
  ==========================================================*/
  testStep("Step 17", "SFD UnLock OTA Persistent Starting");

  @sysvar::SFDRequest::UnlockRoleType = 7;  /* OTA_Persistent - update if needed */
  rc = UnlockSfdRole_PD();
  if (rc != 0) { testStepFail("Result 17", "SFD OTA unlock failed, rc=%d", rc); return; }
  testStepPass("Result 17", "SFD unlock sequence for OTA Role executed");

  testWaitForTimeout(500);

  /*==========================================================
    STEP 18 - Read DID 0x0174 (OTA unlocked)
    Expected: 62 01 74 06 03 01 FF
  ==========================================================*/
  testStep("Step 18", "Read DID 0x0174 - OTA Role unlocked");

  SetDefaultDiagnosticSession_PD(3000);
  SetExtendedDiagnosticSession_PD(3000);

  reqRaw[0] = 0x22; reqRaw[1] = 0x01; reqRaw[2] = 0x74;
  diagResize(didReq, 3);
  diagSetPrimitiveData(didReq, reqRaw, 3);
  diagSendRequest(didReq);
  testWaitForDiagResponse(didReq, 5000);
  nrc = diagGetLastResponseCode(didReq);
  if (nrc >= 0) { len = -(0x100 + nrc); }
  else { diagGetLastResponse(didReq, didResp); len = diagGetPrimitiveData(didResp, readBuf, elcount(readBuf)); }

  if (len > 0)
  {
    testStepPass("Result 18", "Positive response: 62 01 74 %02X %02X %02X %02X (len=%d)",
      readBuf[3], readBuf[4], readBuf[5], readBuf[6], len);
    if (readBuf[3] == 0x06 && readBuf[6] == 0xFF)
      testStepPass("Result 18 check", "State=0x06 (OTA), persistent=0xFF as expected");
    else
      testStepFail("Result 18 check",
        "Unexpected: readBuf[3]=0x%02X readBuf[6]=0x%02X (expected 0x06 / 0xFF)",
        readBuf[3], readBuf[6]);
  }
  else if (len <= -256) { testStepFail("Result 18", "NRC=0x%02X", (-len)-256); }
  else { testStepFail("Result 18", "Read failed, rc=%d", len); }

  /*==========================================================
    POST-CONDITIONS
  ==========================================================*/
  testWaitForTimeout(1000);
  testStepPass("Postcondition", "ECU SFD unlocked (OTA Role, persistent)");
  write("=== TC_HCP5_DIAG_11_001_DID_Unlock_State_0x0174_PD END ===");
}

void MainTest()
{
  TC_HCP5_DIAG_11_001_DID_Unlock_State_0x0174_PD();
}
