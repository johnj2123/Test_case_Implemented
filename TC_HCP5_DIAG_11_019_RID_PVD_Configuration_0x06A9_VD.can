includes
{
  #include "../diaglibrary.cin"
  #include "../DiagLibraryAI.cin"
}

/*=============================================================================
  Test Case : TC_HCP5_DIAG_11_019_RID_PVD_Configuration_0x06A9_VD
  Source     : HCP5_SysTest
  Domain     : VD
  Purpose    : Verifies RID 0x06A9 (PVD Configuration) behaviour on VD domain:
               - Rejected (NRC 0x31) in Default session
               - Rejected (NRC 0x31) after Extended -> SetExtendedSevice
                 (pass report does NOT enter actual Programming 0x02 for step 3)
               - Returns positive response in Extended session for all
                 subfunction variants: 0x00 through 0x06

  NOTE - Deviations from spec (see diff_between_spec_report.xlsx rows 46-48):
    1. Session for NRC check (step 3 in spec): Spec says enter Programming (0x02).
       Pass report skips Programming; uses Extended -> ClearDTC -> Extended ->
       SetExtendedSevice (~1835ms), then sends 06A9 sf=00 and gets NRC 0x31.
       Script follows pass report exactly for step 2/3.
    2. Positive response payload: Spec expects byte[5] to match requested
       subfunction (0x00-0x06). Script explicitly checks byte[5] per spec.
    3. Inter-call delay: Pass report sends each positive 06A9 call ~2700ms apart.
       Script uses 2700ms wait between positive calls to match.
    4. DoIP activation line: Pass report preparation step 5 calls
       Eth_ActivationLine_Off(). Script calls DoIPActivationLineInactive()
       in preconditions — required to avoid NRC 0x22 on session transitions.

  Subfunction byte (06A9 request byte[4]) mapping per spec:
    0x00 = PVD config entry 0
    0x01 = PVD config entry 1
    0x02 = PVD config entry 2
    0x03 = PVD config entry 3
    0x04 = PVD config entry 4
    0x05 = PVD config entry 5
    0x06 = PVD config entry 6

  Preconditions:
    1. Clamp 30 enabled
    2. Clamp 15 enabled
    3. Restbus simulation running
    4. Connect Diag Client to Diag-CAN
    5. DoIP activation line inactive
    6. Default Diagnostic Session (0x01)

  Post-Conditions: none
=============================================================================*/
testcase TC_HCP5_DIAG_11_019_RID_PVD_Configuration_0x06A9_VD()
{
  diagRequest  HCP5_Diag_VD.*  req;
  diagResponse HCP5_Diag_VD.*  resp;
  diagRequest  HCP5_Diag_VD.SetExtendedSevice  extSevReq;
  diagResponse HCP5_Diag_VD.SetExtendedSevice  extSevResp;

  byte    rawReq[8];
  byte    readBuf[4095];
  byte    dtcGroup[3];
  long    len;
  long    rc;
  long    nrc;
  long    receivedNRC;

  write("=== TC_HCP5_DIAG_11_019_RID_PVD_Configuration_0x06A9_VD START ===");

  /*==========================================================
    PRECONDITIONS
  ==========================================================*/
  EnableClamp30();
  testStepPass("Precondition", "Clamp 30 enabled");

  EnableClamp15();
  testStepPass("Precondition", "Clamp 15 enabled");

  StartRestBusSimulation();
  testStepPass("Precondition", "Restbus simulation running");

  testWaitForTimeout(20000);  /* ECU boot after Klemme15 */

  ConnectDiagClientToDiagCAN();
  testStepPass("Precondition", "Diag client connected to Diag-CAN");

  testWaitForTimeout(500);

  /* DoIP activation line must be inactive — required for session transitions on VD */
  DoIPActivationLineInactive();
  testStepPass("Precondition", "DoIP activation line inactive");

  testWaitForTimeout(500);

  /* Ensure Default session */
  SetDefaultDiagnosticSession_VD(3000);
  testStepPass("Precondition", "Default Session (0x01) established");

  testWaitForTimeout(200);

  /*======================================================
    STEP 1
    Send 31 01 06 A9 00 in Default Session
    Expected: NRC 0x31 (requestOutOfRange)
  ======================================================*/
  testStep("Step 1", "Send 06A9 sf=0x00 in Default Session - expect NRC 0x31");

  rawReq[0] = 0x31; rawReq[1] = 0x01; rawReq[2] = 0x06; rawReq[3] = 0xA9; rawReq[4] = 0x00;
  diagResize(req, 5);
  diagSetPrimitiveData(req, rawReq, 5);
  diagSendRequest(req);
  testWaitForDiagResponse(req, 5000);
  nrc = diagGetLastResponseCode(req);

  if (nrc >= 0)
  {
    receivedNRC = nrc;
    if (receivedNRC == 0x31)
      testStepPass("Result 1", "NRC 0x31 (requestOutOfRange) received as expected in Default session");
    else
      testStepFail("Result 1", "Wrong NRC=0x%02X (expected 0x31) in Default session", receivedNRC);
  }
  else
  {
    diagGetLastResponse(req, resp);
    len = diagGetPrimitiveData(resp, readBuf, elcount(readBuf));
    if (len > 0)
      testStepFail("Result 1", "Unexpected positive response in Default session (len=%d)", len);
    else
      testStepFail("Result 1", "No response / error, rc=%d", len);
  }

  /*======================================================
    STEP 2
    Pass report: Extended -> ClearDTC -> Extended -> SetExtendedSevice (~1835ms)
    Spec: Enter Programming Diagnostics Session 0x02
    Script follows pass report — SetExtendedSevice is the "Programming-adjacent"
    state the ECU uses before accepting 06A9 NRC check (same pattern as TC_013 PD).
  ======================================================*/
  testStep("Step 2", "Enter Extended -> ClearDTC -> Extended -> SetExtendedSevice");

  /* Enter Extended */
  rc = SetExtendedDiagnosticSession_VD(3000);
  if (rc != 0)
  {
    testStepFail("Result 2", "Failed to enter Extended Session");
    return;
  }

  testWaitForTimeout(200);

  /* ClearDTC — as per pass report step 4 */
  dtcGroup[0] = 0xFF; dtcGroup[1] = 0xFF; dtcGroup[2] = 0xFF;
  UdsClearDTC_VD(dtcGroup, 3, 5000);

  testWaitForTimeout(1000);

  /* Re-enter Extended */
  rc = SetExtendedDiagnosticSession_VD(3000);
  if (rc != 0)
  {
    testStepFail("Result 2", "Failed to re-enter Extended Session before SetExtendedSevice");
    return;
  }

  /* SetExtendedSevice — pass report shows ~1835ms response time, use 5000ms timeout */
  diagSendRequest(extSevReq);
  testWaitForDiagResponse(extSevReq, 5000);
  rc = diagGetLastResponseCode(extSevReq);

  if (rc >= 0)
  {
    testStepFail("Result 2", "SetExtendedSevice returned NRC=0x%02X (expected positive)", rc);
    return;
  }

  testStepPass("Result 2", "SetExtendedSevice positive response received (Programming-adjacent state)");

  /*======================================================
    STEP 3
    Send 31 01 06 A9 00 in SetExtendedSevice state
    Expected: NRC 0x31 (requestOutOfRange)
  ======================================================*/
  testStep("Step 3", "Send 06A9 sf=0x00 after SetExtendedSevice - expect NRC 0x31");

  rawReq[0] = 0x31; rawReq[1] = 0x01; rawReq[2] = 0x06; rawReq[3] = 0xA9; rawReq[4] = 0x00;
  diagResize(req, 5);
  diagSetPrimitiveData(req, rawReq, 5);
  diagSendRequest(req);
  testWaitForDiagResponse(req, 5000);
  nrc = diagGetLastResponseCode(req);

  if (nrc >= 0)
  {
    receivedNRC = nrc;
    if (receivedNRC == 0x31)
      testStepPass("Result 3", "NRC 0x31 (requestOutOfRange) received as expected");
    else
      testStepFail("Result 3", "Wrong NRC=0x%02X (expected 0x31)", receivedNRC);
  }
  else
  {
    diagGetLastResponse(req, resp);
    len = diagGetPrimitiveData(resp, readBuf, elcount(readBuf));
    if (len > 0)
      testStepFail("Result 3", "Unexpected positive response (len=%d)", len);
    else
      testStepFail("Result 3", "No response / error, rc=%d", len);
  }

  /*======================================================
    STEP 4
    Recover to Extended Session
    Pass report: Default -> Extended -> 500ms wait before positive variants
  ======================================================*/
  testStep("Step 4", "Enter Extended Diagnostic Session (recover for positive tests)");

  rc = SetDefaultDiagnosticSession_VD(3000);
  if (rc != 0)
  {
    testStepFail("Result 4", "Failed to re-enter Default Session");
    return;
  }

  testWaitForTimeout(200);

  rc = SetExtendedDiagnosticSession_VD(3000);
  if (rc != 0)
  {
    testStepFail("Result 4", "Failed to enter Extended Session");
    return;
  }

  testStepPass("Result 4", "Extended Session (0x03) active");
  testWaitForTimeout(500);

  /*======================================================
    STEPS 5-11
    Send 06A9 sf=0x00..0x06 in Extended Session
    Expected: Positive response 71 01 06 A9 XX <sf>
    Pass report: 2700ms between each call
  ======================================================*/

  /* --- sf=0x00 (Step 5) --- */
  testStep("Step 5", "Send 06A9 sf=0x00 in Extended Session - expect positive");
  rawReq[0] = 0x31; rawReq[1] = 0x01; rawReq[2] = 0x06; rawReq[3] = 0xA9; rawReq[4] = 0x00;
  diagResize(req, 5); diagSetPrimitiveData(req, rawReq, 5);
  diagSendRequest(req); testWaitForDiagResponse(req, 5000);
  nrc = diagGetLastResponseCode(req);
  if (nrc >= 0) { testStepFail("Result 5", "NRC=0x%02X (expected positive)", nrc); }
  else
  {
    diagGetLastResponse(req, resp); len = diagGetPrimitiveData(resp, readBuf, elcount(readBuf));
    if (len > 0 && readBuf[0]==0x71 && readBuf[2]==0x06 && readBuf[3]==0xA9)
    {
      if (len >= 6 && readBuf[5] == 0x00)
        testStepPass("Result 5", "06A9 sf=0x00: positive 71 01 06 A9 XX 00 len=%d", len);
      else
        testStepFail("Result 5", "06A9 sf=0x00: byte[5]=0x%02X (expected 0x00) len=%d", (len>=6)?readBuf[5]:0xFF, len);
    }
    else if (len > 0) testStepFail("Result 5", "Unexpected header: %02X %02X %02X %02X", readBuf[0], readBuf[1], readBuf[2], readBuf[3]);
    else              testStepFail("Result 5", "No response, rc=%d", len);
  }
  testWaitForTimeout(2700);

  /* --- sf=0x01 (Step 6) --- */
  testStep("Step 6", "Send 06A9 sf=0x01 in Extended Session - expect positive");
  rawReq[4] = 0x01; diagResize(req, 5); diagSetPrimitiveData(req, rawReq, 5);
  diagSendRequest(req); testWaitForDiagResponse(req, 5000);
  nrc = diagGetLastResponseCode(req);
  if (nrc >= 0) { testStepFail("Result 6", "NRC=0x%02X (expected positive)", nrc); }
  else
  {
    diagGetLastResponse(req, resp); len = diagGetPrimitiveData(resp, readBuf, elcount(readBuf));
    if (len > 0 && readBuf[0]==0x71 && readBuf[2]==0x06 && readBuf[3]==0xA9)
    {
      if (len >= 6 && readBuf[5] == 0x01)
        testStepPass("Result 6", "06A9 sf=0x01: positive 71 01 06 A9 XX 01 len=%d", len);
      else
        testStepFail("Result 6", "06A9 sf=0x01: byte[5]=0x%02X (expected 0x01) len=%d", (len>=6)?readBuf[5]:0xFF, len);
    }
    else if (len > 0) testStepFail("Result 6", "Unexpected header: %02X %02X %02X %02X", readBuf[0], readBuf[1], readBuf[2], readBuf[3]);
    else              testStepFail("Result 6", "No response, rc=%d", len);
  }
  testWaitForTimeout(2700);

  /* --- sf=0x02 (Step 7) --- */
  testStep("Step 7", "Send 06A9 sf=0x02 in Extended Session - expect positive");
  rawReq[4] = 0x02; diagResize(req, 5); diagSetPrimitiveData(req, rawReq, 5);
  diagSendRequest(req); testWaitForDiagResponse(req, 5000);
  nrc = diagGetLastResponseCode(req);
  if (nrc >= 0) { testStepFail("Result 7", "NRC=0x%02X (expected positive)", nrc); }
  else
  {
    diagGetLastResponse(req, resp); len = diagGetPrimitiveData(resp, readBuf, elcount(readBuf));
    if (len > 0 && readBuf[0]==0x71 && readBuf[2]==0x06 && readBuf[3]==0xA9)
    {
      if (len >= 6 && readBuf[5] == 0x02)
        testStepPass("Result 7", "06A9 sf=0x02: positive 71 01 06 A9 XX 02 len=%d", len);
      else
        testStepFail("Result 7", "06A9 sf=0x02: byte[5]=0x%02X (expected 0x02) len=%d", (len>=6)?readBuf[5]:0xFF, len);
    }
    else if (len > 0) testStepFail("Result 7", "Unexpected header: %02X %02X %02X %02X", readBuf[0], readBuf[1], readBuf[2], readBuf[3]);
    else              testStepFail("Result 7", "No response, rc=%d", len);
  }
  testWaitForTimeout(2700);

  /* --- sf=0x03 (Step 8) --- */
  testStep("Step 8", "Send 06A9 sf=0x03 in Extended Session - expect positive");
  rawReq[4] = 0x03; diagResize(req, 5); diagSetPrimitiveData(req, rawReq, 5);
  diagSendRequest(req); testWaitForDiagResponse(req, 5000);
  nrc = diagGetLastResponseCode(req);
  if (nrc >= 0) { testStepFail("Result 8", "NRC=0x%02X (expected positive)", nrc); }
  else
  {
    diagGetLastResponse(req, resp); len = diagGetPrimitiveData(resp, readBuf, elcount(readBuf));
    if (len > 0 && readBuf[0]==0x71 && readBuf[2]==0x06 && readBuf[3]==0xA9)
    {
      if (len >= 6 && readBuf[5] == 0x03)
        testStepPass("Result 8", "06A9 sf=0x03: positive 71 01 06 A9 XX 03 len=%d", len);
      else
        testStepFail("Result 8", "06A9 sf=0x03: byte[5]=0x%02X (expected 0x03) len=%d", (len>=6)?readBuf[5]:0xFF, len);
    }
    else if (len > 0) testStepFail("Result 8", "Unexpected header: %02X %02X %02X %02X", readBuf[0], readBuf[1], readBuf[2], readBuf[3]);
    else              testStepFail("Result 8", "No response, rc=%d", len);
  }
  testWaitForTimeout(2700);

  /* --- sf=0x04 (Step 9) --- */
  testStep("Step 9", "Send 06A9 sf=0x04 in Extended Session - expect positive");
  rawReq[4] = 0x04; diagResize(req, 5); diagSetPrimitiveData(req, rawReq, 5);
  diagSendRequest(req); testWaitForDiagResponse(req, 5000);
  nrc = diagGetLastResponseCode(req);
  if (nrc >= 0) { testStepFail("Result 9", "NRC=0x%02X (expected positive)", nrc); }
  else
  {
    diagGetLastResponse(req, resp); len = diagGetPrimitiveData(resp, readBuf, elcount(readBuf));
    if (len > 0 && readBuf[0]==0x71 && readBuf[2]==0x06 && readBuf[3]==0xA9)
    {
      if (len >= 6 && readBuf[5] == 0x04)
        testStepPass("Result 9", "06A9 sf=0x04: positive 71 01 06 A9 XX 04 len=%d", len);
      else
        testStepFail("Result 9", "06A9 sf=0x04: byte[5]=0x%02X (expected 0x04) len=%d", (len>=6)?readBuf[5]:0xFF, len);
    }
    else if (len > 0) testStepFail("Result 9", "Unexpected header: %02X %02X %02X %02X", readBuf[0], readBuf[1], readBuf[2], readBuf[3]);
    else              testStepFail("Result 9", "No response, rc=%d", len);
  }
  testWaitForTimeout(2700);

  /* --- sf=0x05 (Step 10) --- */
  testStep("Step 10", "Send 06A9 sf=0x05 in Extended Session - expect positive");
  rawReq[4] = 0x05; diagResize(req, 5); diagSetPrimitiveData(req, rawReq, 5);
  diagSendRequest(req); testWaitForDiagResponse(req, 5000);
  nrc = diagGetLastResponseCode(req);
  if (nrc >= 0) { testStepFail("Result 10", "NRC=0x%02X (expected positive)", nrc); }
  else
  {
    diagGetLastResponse(req, resp); len = diagGetPrimitiveData(resp, readBuf, elcount(readBuf));
    if (len > 0 && readBuf[0]==0x71 && readBuf[2]==0x06 && readBuf[3]==0xA9)
    {
      if (len >= 6 && readBuf[5] == 0x05)
        testStepPass("Result 10", "06A9 sf=0x05: positive 71 01 06 A9 XX 05 len=%d", len);
      else
        testStepFail("Result 10", "06A9 sf=0x05: byte[5]=0x%02X (expected 0x05) len=%d", (len>=6)?readBuf[5]:0xFF, len);
    }
    else if (len > 0) testStepFail("Result 10", "Unexpected header: %02X %02X %02X %02X", readBuf[0], readBuf[1], readBuf[2], readBuf[3]);
    else              testStepFail("Result 10", "No response, rc=%d", len);
  }
  testWaitForTimeout(2700);

  /* --- sf=0x06 (Step 11) --- */
  testStep("Step 11", "Send 06A9 sf=0x06 in Extended Session - expect positive");
  rawReq[4] = 0x06; diagResize(req, 5); diagSetPrimitiveData(req, rawReq, 5);
  diagSendRequest(req); testWaitForDiagResponse(req, 5000);
  nrc = diagGetLastResponseCode(req);
  if (nrc >= 0) { testStepFail("Result 11", "NRC=0x%02X (expected positive)", nrc); }
  else
  {
    diagGetLastResponse(req, resp); len = diagGetPrimitiveData(resp, readBuf, elcount(readBuf));
    if (len > 0 && readBuf[0]==0x71 && readBuf[2]==0x06 && readBuf[3]==0xA9)
    {
      if (len >= 6 && readBuf[5] == 0x06)
        testStepPass("Result 11", "06A9 sf=0x06: positive 71 01 06 A9 XX 06 len=%d", len);
      else
        testStepFail("Result 11", "06A9 sf=0x06: byte[5]=0x%02X (expected 0x06) len=%d", (len>=6)?readBuf[5]:0xFF, len);
    }
    else if (len > 0) testStepFail("Result 11", "Unexpected header: %02X %02X %02X %02X", readBuf[0], readBuf[1], readBuf[2], readBuf[3]);
    else              testStepFail("Result 11", "No response, rc=%d", len);
  }

  /*==========================================================
    POST-CONDITIONS
  ==========================================================*/
  testWaitForTimeout(1000);
  testStepPass("Postcondition", "none");
  write("=== TC_HCP5_DIAG_11_019_RID_PVD_Configuration_0x06A9_VD END ===");
}

void MainTest()
{
  TC_HCP5_DIAG_11_019_RID_PVD_Configuration_0x06A9_VD();
}
