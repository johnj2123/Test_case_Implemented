includes
{
  #include "../diaglibrary.cin"
  #include "../DiagLibraryAI.cin"
}

/*=============================================================================
  Test Case : TC_HCP5_DIAG_11_003_RID_Cancel_Unlocking_0xC005_PD
  Source     : HCP5_SysTest
  Domain     : PD
  Purpose    : Checks that RID 0xC005 (Cancel Unlocking / SFD Lock) is correctly
               implemented on PD. Routine rejected (NRC 0x31) in Default and
               Programming sessions, positive in Extended. After execution the
               SFD locked state is confirmed via DID 0x0174.

  NOTE - Deviation from spec (see diff_between_spec_report.xlsx):
    Passing report performs a full unlock sequence (SFD_manager SuperUser) then
    re-locks via C005 and verifies 0174 confirms locked state.
    Spec only describes the basic NRC/positive session checks and one 0174 read.
    Script follows passing report order.

  Preconditions:
    1. Clamp 30 enabled
    2. Clamp 15 enabled
    3. Restbus simulation running
    4. Connect Diag Client to Diag-CAN
    5. Default Diagnostic Session 0x01

  Post-Conditions: none
=============================================================================*/
testcase TC_HCP5_DIAG_11_003_RID_Cancel_Unlocking_0xC005_PD()
{
  diagRequest  HCP5_Diag_PD.SFD_Lock req;
  diagResponse HCP5_Diag_PD.SFD_Lock resp;

  byte rawReq[4];
  byte readBuf[4095];
  long rc;
  long nrc;
  long len;
  long receivedNRC;

  write("=== TC_HCP5_DIAG_11_003_RID_Cancel_Unlocking_0xC005_PD START ===");

  /*==========================================================
    PRECONDITIONS
  ==========================================================*/
  EnableClamp30();
  testStepPass("Precondition", "Clamp 30 enabled");

  EnableClamp15();
  testStepPass("Precondition", "Clamp 15 enabled");

  StartRestBusSimulation();
  testStepPass("Precondition", "Restbus simulation running");

  testWaitForTimeout(20000);  /* Wait for ECU boot after Klemme15 */

  ConnectDiagClientToDiagCAN();
  testStepPass("Precondition", "Diag client connected to Diag-CAN");

  testWaitForTimeout(500);

  /* Lock SFD first (handles any persistent unlock from a previous run) */
  rc = SetExtendedDiagnosticSession_PD(3000);
  if (rc != 0) { testStepFail("Precondition", "Failed to enter Extended Session for SFD lock"); return; }

  rc = SFD_lock_PD();
  if (rc != 0) { testStepFail("Precondition", "Failed to lock SFD, rc=%d", rc); return; }
  testStepPass("Precondition", "ECU SFD locked");

  /* Power cycle AFTER locking — persistent unlock survives Klemme15 but lock command clears it */
  DisableClamp15();
  testStepPass("Precondition", "Clamp 15 disabled (power cycle to flush persistent state)");
  testWaitForTimeout(2000);

  EnableClamp15();
  testStepPass("Precondition", "Clamp 15 re-enabled");

  testWaitForTimeout(20000);  /* Wait for ECU reboot */

  ConnectDiagClientToDiagCAN();
  testStepPass("Precondition", "Diag client reconnected after power cycle");

  testWaitForTimeout(500);

  rc = SetExtendedDiagnosticSession_PD(3000);
  if (rc != 0) { testStepFail("Precondition", "Failed to enter Extended Session after reboot"); return; }

  /* Confirm locked via 0174: Default -> Extended -> raw 22 01 74 */
  rc = SetDefaultDiagnosticSession_PD(3000);
  if (rc != 0) { testStepFail("Precondition", "Failed to enter Default Session"); return; }
  rc = SetExtendedDiagnosticSession_PD(3000);
  if (rc != 0) { testStepFail("Precondition", "Failed to enter Extended Session"); return; }

  rawReq[0] = 0x22; rawReq[1] = 0x01; rawReq[2] = 0x74;
  diagResize(req, 3);
  diagSetPrimitiveData(req, rawReq, 3);
  diagSendRequest(req);
  testWaitForDiagResponse(req, 5000);
  nrc = diagGetLastResponseCode(req);
  if (nrc >= 0) { len = -(0x100 + nrc); }
  else { diagGetLastResponse(req, resp); len = diagGetPrimitiveData(resp, readBuf, elcount(readBuf)); }

  if (len > 0)
  {
    testStepPass("Precondition", "DID 0x0174 response: 0x%02X 0x%02X 0x%02X 0x%02X 0x%02X 0x%02X 0x%02X (len=%d)",
      readBuf[0], readBuf[1], readBuf[2], readBuf[3], readBuf[4], readBuf[5], readBuf[6], len);
    if (readBuf[3] == 0x00)
      testStepPass("Precondition", "SFD locked confirmed (Role=0x00)");
    else
    {
      testStepFail("Precondition", "SFD not locked — Role=0x%02X (expected 0x00)", readBuf[3]);
      return;
    }
  }
  else
  {
    testStepFail("Precondition", "0174 read failed, rc=%d", len);
    return;
  }

  rc = SetDefaultDiagnosticSession_PD(3000);
  if (rc != 0) { testStepFail("Precondition", "Failed to return to Default Session"); return; }
  testStepPass("Precondition", "Default Diagnostic Session 0x01 entered");

  testWaitForTimeout(500);

  /*======================================================
    STEP 1
    Send RID 0xC005 in Default Session
    Expected: NRC 0x31
  ======================================================*/
  testStep("Step 1", "Send RID 0xC005 StartRoutine in Default Session");

  rawReq[0] = 0x31; rawReq[1] = 0x01; rawReq[2] = 0xC0; rawReq[3] = 0x05;
  diagResize(req, 4);
  diagSetPrimitiveData(req, rawReq, 4);
  diagSendRequest(req);
  testWaitForDiagResponse(req, 5000);
  nrc = diagGetLastResponseCode(req);
  if (nrc >= 0) { len = -(0x100 + nrc); }
  else { diagGetLastResponse(req, resp); len = diagGetPrimitiveData(resp, readBuf, elcount(readBuf)); }

  if (len <= -256)
  {
    receivedNRC = (-len) - 256;
    if (receivedNRC == 0x31)
      testStepPass("Result 1", "NRC 0x31 received as expected in Default Session");
    else
      testStepFail("Result 1", "Unexpected NRC=0x%02X (expected 0x31)", receivedNRC);
  }
  else
    testStepFail("Result 1", "Negative response (NRC 0x31) expected, got positive rc=%d", len);

  testWaitForTimeout(500);

  /*======================================================
    STEP 2 - Default session (10 01)
  ======================================================*/
  testStep("Step 2", "Enter Default Session (10 01)");
  rc = SetDefaultDiagnosticSession_PD(3000);
  if (rc != 0) { testStepFail("Result 2", "Failed to enter Default Session"); return; }
  testStepPass("Result 2", "Default Session entered");

  /*======================================================
    STEP 3 - Extended session (10 03)
  ======================================================*/
  testStep("Step 3", "Enter Extended Session (10 03)");
  rc = SetExtendedDiagnosticSession_PD(3000);
  if (rc != 0) { testStepFail("Result 3", "Failed to enter Extended Session"); return; }
  testStepPass("Result 3", "Extended Session entered");

  /*======================================================
    STEP 4 - Programming session (10 02) via SetExtendedService
  ======================================================*/
  testStep("Step 4", "Enter Programming Session (10 02)");
  rc = SetProgrammingDiagnosticSession_PD(3000);
  if (rc != 0) { testStepFail("Result 4", "Failed to enter Programming Session"); return; }
  testStepPass("Result 4", "Programming Session entered");

  testWaitForTimeout(500);

  /*======================================================
    STEP 5
    Send RID 0xC005 in Programming Session
    Expected: NRC 0x31
  ======================================================*/
  testStep("Step 5", "Send RID 0xC005 StartRoutine in Programming Session");

  rawReq[0] = 0x31; rawReq[1] = 0x01; rawReq[2] = 0xC0; rawReq[3] = 0x05;
  diagResize(req, 4);
  diagSetPrimitiveData(req, rawReq, 4);
  diagSendRequest(req);
  testWaitForDiagResponse(req, 5000);
  nrc = diagGetLastResponseCode(req);
  if (nrc >= 0) { len = -(0x100 + nrc); }
  else { diagGetLastResponse(req, resp); len = diagGetPrimitiveData(resp, readBuf, elcount(readBuf)); }

  if (len <= -256)
  {
    receivedNRC = (-len) - 256;
    if (receivedNRC == 0x31)
      testStepPass("Result 5", "NRC 0x31 received as expected in Programming Session");
    else
      testStepFail("Result 5", "Unexpected NRC=0x%02X (expected 0x31)", receivedNRC);
  }
  else
    testStepFail("Result 5", "Negative response (NRC 0x31) expected, got positive rc=%d", len);

  testWaitForTimeout(500);

  /*======================================================
    STEP 6 - Default session (10 01)
  ======================================================*/
  testStep("Step 6", "Enter Default Session (10 01)");
  rc = SetDefaultDiagnosticSession_PD(3000);
  if (rc != 0) { testStepFail("Result 6", "Failed to enter Default Session"); return; }
  testStepPass("Result 6", "Default Session entered");

  /*======================================================
    STEP 7 - Extended session (10 03)
  ======================================================*/
  testStep("Step 7", "Enter Extended Session (10 03)");
  rc = SetExtendedDiagnosticSession_PD(3000);
  if (rc != 0) { testStepFail("Result 7", "Failed to enter Extended Session"); return; }
  testStepPass("Result 7", "Extended Session entered");

  testWaitForTimeout(500);

  /*======================================================
    STEP 8
    Send RID 0xC005 in Extended Session
    Expected: Positive response, routineStatusRecord=0x24, Response=0x00
  ======================================================*/
  testStep("Step 8", "Send RID 0xC005 StartRoutine in Extended Session");

  rawReq[0] = 0x31; rawReq[1] = 0x01; rawReq[2] = 0xC0; rawReq[3] = 0x05;
  diagResize(req, 4);
  diagSetPrimitiveData(req, rawReq, 4);
  diagSendRequest(req);
  testWaitForDiagResponse(req, 5000);
  nrc = diagGetLastResponseCode(req);
  if (nrc >= 0) { len = -(0x100 + nrc); }
  else { diagGetLastResponse(req, resp); len = diagGetPrimitiveData(resp, readBuf, elcount(readBuf)); }

  if (len > 0)
  {
    testStepPass("Result 8", "Positive response for RID 0xC005 in Extended (len=%d)", len);
    testStepPass("Result 8 raw", "Response: 0x%02X 0x%02X 0x%02X 0x%02X 0x%02X 0x%02X",
      readBuf[0], readBuf[1], readBuf[2], readBuf[3], readBuf[4], readBuf[5]);
    /* wire: 71 01 C0 05 routineStatusRecord Response */
    if (readBuf[0] == 0x71 && readBuf[1] == 0x01 && readBuf[2] == 0xC0 && readBuf[3] == 0x05)
      testStepPass("Result 8 check", "SID+RID echo correct (71 01 C0 05)");
    else
      testStepFail("Result 8 check", "SID+RID echo wrong: 0x%02X 0x%02X 0x%02X 0x%02X",
        readBuf[0], readBuf[1], readBuf[2], readBuf[3]);
    if (len >= 6 && readBuf[4] == 0x24 && readBuf[5] == 0x00)
      testStepPass("Result 8 check2", "routineStatusRecord=0x24, Response=0x00 as expected");
    else if (len >= 6)
      testStepFail("Result 8 check2", "Unexpected: routineStatusRecord=0x%02X Response=0x%02X (expected 0x24, 0x00)",
        readBuf[4], readBuf[5]);
    else
      testStepFail("Result 8 check2", "Response too short for routineStatusRecord check (len=%d)", len);
  }
  else if (len <= -256)
    testStepFail("Result 8", "Unexpected NRC=0x%02X", (-len)-256);
  else
    testStepFail("Result 8", "RID 0xC005 failed, rc=%d", len);

  testWaitForTimeout(500);

  /*======================================================
    STEP 9
    Read DID 0x0174 in Extended Session (after lock via C005)
    Expected: Positive, Role=0x00 Type=0x00 (locked)
  ======================================================*/
  testStep("Step 9", "Read DID 0x0174 in Extended Session - confirm SFD locked");

  rawReq[0] = 0x22; rawReq[1] = 0x01; rawReq[2] = 0x74;
  diagResize(req, 3);
  diagSetPrimitiveData(req, rawReq, 3);
  diagSendRequest(req);
  testWaitForDiagResponse(req, 5000);
  nrc = diagGetLastResponseCode(req);
  if (nrc >= 0) { len = -(0x100 + nrc); }
  else { diagGetLastResponse(req, resp); len = diagGetPrimitiveData(resp, readBuf, elcount(readBuf)); }

  if (len > 0)
  {
    testStepPass("Result 9", "Positive response for DID 0x0174 (len=%d)", len);
    testStepPass("Result 9 raw", "Response: 0x%02X 0x%02X 0x%02X 0x%02X 0x%02X 0x%02X 0x%02X",
      readBuf[0], readBuf[1], readBuf[2], readBuf[3], readBuf[4], readBuf[5], readBuf[6]);
    if (readBuf[3] == 0x00 && readBuf[4] == 0x00)
      testStepPass("Result 9 check", "Role=0x00, Type=0x00 - SFD locked confirmed");
    else
      testStepFail("Result 9 check", "Unexpected: Role=0x%02X Type=0x%02X (expected 0x00, 0x00)",
        readBuf[3], readBuf[4]);
  }
  else if (len <= -256)
    testStepFail("Result 9", "NRC=0x%02X", (-len)-256);
  else
    testStepFail("Result 9", "Read DID 0x0174 failed, rc=%d", len);

  testWaitForTimeout(500);

  /*======================================================
    STEP 10
    SFD Unlock SuperUser via SFD_manager (security token unlock)
    Passing report: RoutineReqTkn -> SFD_manager(status=4) -> 62 01 74 04 03 01 FF
    We use SFD_unlock_superuser_PD() if available, else raw approach
  ======================================================*/
  testStep("Step 10", "SFD UnLock SuperUser Starting");

  /* Re-enter Default then Extended before unlock */
  rc = SetDefaultDiagnosticSession_PD(3000);
  if (rc != 0) { testStepFail("Result 10", "Failed to enter Default Session"); return; }
  rc = SetExtendedDiagnosticSession_PD(3000);
  if (rc != 0) { testStepFail("Result 10", "Failed to enter Extended Session"); return; }

    /* UnlockRoleType=1 → Superuser_Persistent, uses UnlockSfdRole_PD() internally */
  rc = UnlockSfdRole_Dynamic_PD(1);
  if (rc != 0)
  {
    testStepFail("Result 10", "SFD SuperUser unlock failed, rc=%d", rc);
    return;
  }
  testStepPass("Result 10", "SFD UnLock SuperUser completed");

  /* Confirm unlock: Default -> Extended -> 22 01 74, expect Role=0x04 */
  rc = SetDefaultDiagnosticSession_PD(3000);
  if (rc != 0) { testStepFail("Result 10", "Failed to enter Default for 0174 check"); return; }
  rc = SetExtendedDiagnosticSession_PD(3000);
  if (rc != 0) { testStepFail("Result 10", "Failed to enter Extended for 0174 check"); return; }

  rawReq[0] = 0x22; rawReq[1] = 0x01; rawReq[2] = 0x74;
  diagResize(req, 3);
  diagSetPrimitiveData(req, rawReq, 3);
  diagSendRequest(req);
  testWaitForDiagResponse(req, 5000);
  nrc = diagGetLastResponseCode(req);
  if (nrc >= 0) { len = -(0x100 + nrc); }
  else { diagGetLastResponse(req, resp); len = diagGetPrimitiveData(resp, readBuf, elcount(readBuf)); }

  if (len > 0)
  {
    testStepPass("Result 10 raw", "Response: 0x%02X 0x%02X 0x%02X 0x%02X 0x%02X 0x%02X 0x%02X",
      readBuf[0], readBuf[1], readBuf[2], readBuf[3], readBuf[4], readBuf[5], readBuf[6]);
    if (readBuf[3] == 0x04 && readBuf[4] == 0x03)
      testStepPass("Result 10 check", "ECU SFD unlocked - Role=0x04, Type=0x03 confirmed");
    else
      testStepFail("Result 10 check", "Unexpected: Role=0x%02X Type=0x%02X (expected 0x04, 0x03)",
        readBuf[3], readBuf[4]);
  }
  else
    testStepFail("Result 10 check", "0174 read failed after unlock");

  testWaitForTimeout(500);

  /*======================================================
    STEP 11
    Read 0x0174: Role=0x04, Duration=0xFF (unlocked SuperUser persistent)
  ======================================================*/
  testStep("Step 11", "Read DID 0x0174 - confirm unlocked state (Role=0x04, Duration=0xFF)");

  rawReq[0] = 0x22; rawReq[1] = 0x01; rawReq[2] = 0x74;
  diagResize(req, 3);
  diagSetPrimitiveData(req, rawReq, 3);
  diagSendRequest(req);
  testWaitForDiagResponse(req, 5000);
  nrc = diagGetLastResponseCode(req);
  if (nrc >= 0) { len = -(0x100 + nrc); }
  else { diagGetLastResponse(req, resp); len = diagGetPrimitiveData(resp, readBuf, elcount(readBuf)); }

  if (len > 0)
  {
    testStepPass("Result 11", "Positive response for DID 0x0174 (len=%d)", len);
    testStepPass("Result 11 raw", "Response: 0x%02X 0x%02X 0x%02X 0x%02X 0x%02X 0x%02X 0x%02X",
      readBuf[0], readBuf[1], readBuf[2], readBuf[3], readBuf[4], readBuf[5], readBuf[6]);
    if (readBuf[3] == 0x04 && readBuf[6] == 0xFF)
      testStepPass("Result 11 check", "Role=0x04, Duration=0xFF as expected");
    else
      testStepFail("Result 11 check", "Unexpected: Role=0x%02X Duration=0x%02X (expected 0x04, 0xFF)",
        readBuf[3], readBuf[6]);
  }
  else if (len <= -256)
    testStepFail("Result 11", "NRC=0x%02X", (-len)-256);
  else
    testStepFail("Result 11", "Read DID 0x0174 failed, rc=%d", len);

  testWaitForTimeout(500);

  /*======================================================
    STEP 12
    Send RID 0xC005 in Extended Session (cancel/re-lock)
    Expected: Positive response
  ======================================================*/
  testStep("Step 12", "Send RID 0xC005 in Extended Session (cancel unlock / re-lock)");

  rawReq[0] = 0x31; rawReq[1] = 0x01; rawReq[2] = 0xC0; rawReq[3] = 0x05;
  diagResize(req, 4);
  diagSetPrimitiveData(req, rawReq, 4);
  diagSendRequest(req);
  testWaitForDiagResponse(req, 5000);
  nrc = diagGetLastResponseCode(req);
  if (nrc >= 0) { len = -(0x100 + nrc); }
  else { diagGetLastResponse(req, resp); len = diagGetPrimitiveData(resp, readBuf, elcount(readBuf)); }

  if (len > 0)
  {
    testStepPass("Result 12", "Positive response for RID 0xC005 (re-lock) in Extended (len=%d)", len);
    testStepPass("Result 12 raw", "Response: 0x%02X 0x%02X 0x%02X 0x%02X 0x%02X 0x%02X",
      readBuf[0], readBuf[1], readBuf[2], readBuf[3], readBuf[4], readBuf[5]);
    if (readBuf[0] == 0x71 && readBuf[1] == 0x01 && readBuf[2] == 0xC0 && readBuf[3] == 0x05)
      testStepPass("Result 12 check", "SID+RID echo correct (71 01 C0 05)");
    else
      testStepFail("Result 12 check", "SID+RID echo wrong: 0x%02X 0x%02X 0x%02X 0x%02X",
        readBuf[0], readBuf[1], readBuf[2], readBuf[3]);
  }
  else if (len <= -256)
    testStepFail("Result 12", "Unexpected NRC=0x%02X", (-len)-256);
  else
    testStepFail("Result 12", "RID 0xC005 re-lock failed, rc=%d", len);

  testWaitForTimeout(500);

  /*======================================================
    STEP 13
    Read DID 0x0174 - confirm locked after C005
    Expected: Role=0x00, Type=0x00, Status=0x01, Duration=0x00
  ======================================================*/
  testStep("Step 13", "Read DID 0x0174 - confirm SFD locked after C005");

  rawReq[0] = 0x22; rawReq[1] = 0x01; rawReq[2] = 0x74;
  diagResize(req, 3);
  diagSetPrimitiveData(req, rawReq, 3);
  diagSendRequest(req);
  testWaitForDiagResponse(req, 5000);
  nrc = diagGetLastResponseCode(req);
  if (nrc >= 0) { len = -(0x100 + nrc); }
  else { diagGetLastResponse(req, resp); len = diagGetPrimitiveData(resp, readBuf, elcount(readBuf)); }

  if (len > 0)
  {
    testStepPass("Result 13", "Positive response for DID 0x0174 (len=%d)", len);
    testStepPass("Result 13 raw", "Response: 0x%02X 0x%02X 0x%02X 0x%02X 0x%02X 0x%02X 0x%02X",
      readBuf[0], readBuf[1], readBuf[2], readBuf[3], readBuf[4], readBuf[5], readBuf[6]);
    /* Role=0x00, Type=0x00, Duration=0x00 → SFD locked */
    if (readBuf[3] == 0x00 && readBuf[4] == 0x00 && readBuf[6] == 0x00)
      testStepPass("Result 13 check", "Role=0x00, Type=0x00, Duration=0x00 - SFD locked confirmed");
    else
      testStepFail("Result 13 check", "Unexpected: Role=0x%02X Type=0x%02X Duration=0x%02X (expected 0x00, 0x00, 0x00)",
        readBuf[3], readBuf[4], readBuf[6]);
  }
  else if (len <= -256)
    testStepFail("Result 13", "NRC=0x%02X", (-len)-256);
  else
    testStepFail("Result 13", "Read DID 0x0174 failed, rc=%d", len);

  /*==========================================================
    POST-CONDITIONS
  ==========================================================*/
  testWaitForTimeout(1000);
  testStepPass("Postcondition", "none");
  write("=== TC_HCP5_DIAG_11_003_RID_Cancel_Unlocking_0xC005_PD END ===");
}

void MainTest()
{
  TC_HCP5_DIAG_11_003_RID_Cancel_Unlocking_0xC005_PD();
}
