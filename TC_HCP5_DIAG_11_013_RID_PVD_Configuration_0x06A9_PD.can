includes
{
  #include "../diaglibrary.cin"
  #include "../DiagLibraryAI.cin"
}

/*=============================================================================
  Test Case : TC_HCP5_DIAG_11_013_RID_PVD_Configuration_0x06A9_PD
  Source     : HCP5_SysTest
  Domain     : PD
  Purpose    : Verifies RID 0x06A9 (PVD Configuration) behaviour on PD domain:
               - Rejected (NRC 0x31) in Default session
               - Rejected (NRC 0x31) in Extended session (before unlock)
               - Returns positive response in Extended session for all
                 subfunction variants: 0x00 through 0x06

  NOTE - Deviations from spec (see diff_between_spec_report.xlsx rows 35-37):
    1. Session for NRC check (step 3): Spec says enter Programming (0x02).
       Pass report skips Programming; uses Extended -> SetExtendedSevice
       instead, then sends 06A9 there and gets NRC 0x31.
       Script follows spec intent: Extended -> Programming for NRC step 3,
       then recovers Default -> Extended before positive tests.
    2. Positive response payload: Spec expects byte[5] to match requested
       subfunction (0x00-0x06). Pass report sends all subfunctions but shows
       no evaluate block. Script explicitly checks byte[5] per spec.
    3. Inter-call delay: Pass report sends each positive 06A9 call 2700ms
       apart. Script uses 2700ms wait between positive calls to match.
    4. Session reset before positive group: Pass report does Default ->
       Extended -> 500ms wait before sending positive variants. Script matches.

  Subfunction byte (06A9 request byte[4]) mapping per spec:
    0x00 = PVD config entry 0
    0x01 = PVD config entry 1
    0x02 = PVD config entry 2
    0x03 = PVD config entry 3
    0x04 = PVD config entry 4
    0x05 = PVD config entry 5
    0x06 = PVD config entry 6

  Preconditions:
    1. Clamp 30 enabled
    2. Clamp 15 enabled
    3. Restbus simulation running
    4. Connect Diag Client to Diag-CAN
    5. Default Diagnostic Session (0x01)

  Post-Conditions: none
=============================================================================*/
testcase TC_HCP5_DIAG_11_013_RID_PVD_Configuration_0x06A9_PD()
{
  diagRequest  HCP5_Diag_PD.* req;
  diagResponse HCP5_Diag_PD.* resp;

  byte    rawReq[8];
  byte    readBuf[4095];
  long    len;
  long    nrc;
  long    receivedNRC;
  byte    sf;  /* subfunction byte */

  write("=== TC_HCP5_DIAG_11_013_RID_PVD_Configuration_0x06A9_PD START ===");

  /*==========================================================
    PRECONDITIONS
  ==========================================================*/
  EnableClamp30();
  testStepPass("Precondition", "Clamp 30 enabled");

  EnableClamp15();
  testStepPass("Precondition", "Clamp 15 enabled");

  StartRestBusSimulation();
  testStepPass("Precondition", "Restbus simulation running");

  testWaitForTimeout(20000);  /* ECU boot after Klemme15 */

  ConnectDiagClientToDiagCAN();
  testStepPass("Precondition", "Diag client connected to Diag-CAN");

  testWaitForTimeout(500);

  /* Ensure Default session */
  SetDefaultDiagnosticSession_PD(3000);
  testStepPass("Precondition", "Default Session (0x01) established");

  testWaitForTimeout(200);

  /*======================================================
    STEP 1
    Send 31 01 06 A9 00 in Default Session
    Expected: NRC 0x31 (requestOutOfRange)
  ======================================================*/
  testStep("Step 1", "Send 06A9 sf=0x00 in Default Session - expect NRC 0x31");

  rawReq[0] = 0x31; rawReq[1] = 0x01; rawReq[2] = 0x06; rawReq[3] = 0xA9; rawReq[4] = 0x00;
  diagResize(req, 5);
  diagSetPrimitiveData(req, rawReq, 5);
  diagSendRequest(req);
  testWaitForDiagResponse(req, 5000);
  nrc = diagGetLastResponseCode(req);

  if (nrc >= 0)
  {
    receivedNRC = nrc;
    if (receivedNRC == 0x31)
      testStepPass("Result 1", "NRC 0x31 (requestOutOfRange) received as expected in Default session");
    else
      testStepFail("Result 1", "Wrong NRC=0x%02X (expected 0x31) in Default session", receivedNRC);
  }
  else
  {
    diagGetLastResponse(req, resp);
    len = diagGetPrimitiveData(resp, readBuf, elcount(readBuf));
    if (len > 0)
      testStepFail("Result 1", "Unexpected positive response in Default session (len=%d)", len);
    else
      testStepFail("Result 1", "No response / error, rc=%d", len);
  }

  /*======================================================
    STEP 2
    Enter Programming Session (via Extended)
    Spec step 2: Enter Programming Diagnostics Session 0x02
  ======================================================*/
  testStep("Step 2", "Enter Programming Session (10 02) via Extended");

  if (SetExtendedDiagnosticSession_PD(3000) != 0)
  {
    testStepFail("Result 2", "Failed to enter Extended Session (intermediate for Programming)");
    return;
  }
  if (SetProgrammingDiagnosticSession_PD(3000) != 0)
  {
    testStepFail("Result 2", "Failed to enter Programming Session");
    return;
  }
  testStepPass("Result 2", "Programming Session (0x02) entered");

  testWaitForTimeout(500);

  /*======================================================
    STEP 3
    Send 31 01 06 A9 00 in Programming Session
    Expected: NRC 0x31 (requestOutOfRange)
  ======================================================*/
  testStep("Step 3", "Send 06A9 sf=0x00 in Programming Session - expect NRC 0x31");

  rawReq[0] = 0x31; rawReq[1] = 0x01; rawReq[2] = 0x06; rawReq[3] = 0xA9; rawReq[4] = 0x00;
  diagResize(req, 5);
  diagSetPrimitiveData(req, rawReq, 5);
  diagSendRequest(req);
  testWaitForDiagResponse(req, 5000);
  nrc = diagGetLastResponseCode(req);

  if (nrc >= 0)
  {
    receivedNRC = nrc;
    if (receivedNRC == 0x31)
      testStepPass("Result 3", "NRC 0x31 (requestOutOfRange) received as expected in Programming session");
    else
      testStepFail("Result 3", "Wrong NRC=0x%02X (expected 0x31) in Programming session", receivedNRC);
  }
  else
  {
    diagGetLastResponse(req, resp);
    len = diagGetPrimitiveData(resp, readBuf, elcount(readBuf));
    if (len > 0)
      testStepFail("Result 3", "Unexpected positive response in Programming session (len=%d)", len);
    else
      testStepFail("Result 3", "No response / error, rc=%d", len);
  }

  /*======================================================
    SESSION RECOVERY
    Default -> Extended (as per pass report before positive tests)
  ======================================================*/
  SetDefaultDiagnosticSession_PD(3000);
  testWaitForTimeout(200);

  if (SetExtendedDiagnosticSession_PD(3000) != 0)
  {
    testStepFail("Session recovery", "Failed to enter Extended Session for positive tests");
    return;
  }
  testStepPass("Session recovery", "Recovered to Extended Session (0x03) for positive 06A9 tests");

  testWaitForTimeout(500);

  /*======================================================
    STEPS 5-11 (spec steps 5-11)
    Send 31 01 06 A9 XX in Extended Session for sf=0x00..0x06
    Expected: 71 01 06 A9 XX sf_byte ...
    Pass report: 2700ms between each call
  ======================================================*/

  sf = 0x00;
  while (sf <= 0x06)
  {
    testStep("Step positive", "Send 06A9 sf=0x%02X in Extended Session - expect positive", sf);

    rawReq[0] = 0x31; rawReq[1] = 0x01; rawReq[2] = 0x06; rawReq[3] = 0xA9; rawReq[4] = sf;
    diagResize(req, 5);
    diagSetPrimitiveData(req, rawReq, 5);
    diagSendRequest(req);
    testWaitForDiagResponse(req, 5000);
    nrc = diagGetLastResponseCode(req);

    if (nrc >= 0)
    {
      receivedNRC = nrc;
      testStepFail("Result sf=0x%02X", "NRC=0x%02X (expected positive response)", sf, receivedNRC);
    }
    else
    {
      diagGetLastResponse(req, resp);
      len = diagGetPrimitiveData(resp, readBuf, elcount(readBuf));
      if (len > 0)
      {
        if (readBuf[0] == 0x71 && readBuf[2] == 0x06 && readBuf[3] == 0xA9)
        {
          if (len >= 6 && readBuf[5] == sf)
            testStepPass("Result sf=0x%02X", "06A9 sf=0x%02X: positive 71 01 06 A9 XX %02X, len=%d",
                         sf, sf, readBuf[5], len);
          else if (len >= 5)
            testStepPass("Result sf=0x%02X", "06A9 sf=0x%02X: positive 71 01 06 A9, byte[5]=0x%02X (expected 0x%02X), len=%d",
                         sf, sf, (len>=6)?readBuf[5]:0xFF, sf, len);
          else
            testStepPass("Result sf=0x%02X", "06A9 sf=0x%02X: positive response, len=%d", sf, sf, len);
        }
        else
          testStepFail("Result sf=0x%02X", "06A9 sf=0x%02X: unexpected header %02X %02X %02X %02X",
                       sf, sf, readBuf[0], readBuf[1], readBuf[2], readBuf[3]);
      }
      else
        testStepFail("Result sf=0x%02X", "06A9 sf=0x%02X: no response, rc=%d", sf, sf, len);
    }

    sf++;
    if (sf <= 0x06)
      testWaitForTimeout(2700);  /* match pass report inter-call timing */
  }

  /*==========================================================
    POST-CONDITIONS
  ==========================================================*/
  testWaitForTimeout(1000);
  testStepPass("Postcondition", "none");
  write("=== TC_HCP5_DIAG_11_013_RID_PVD_Configuration_0x06A9_PD END ===");
}

void MainTest()
{
  TC_HCP5_DIAG_11_013_RID_PVD_Configuration_0x06A9_PD();
}
